## CMakeLists.txt
```
# SPDX-License-Identifier: Apache-2.0
#
# The camera path end to end: a 324x324 frame in DRAM -> frame_fe.c -> the network.
#
#   west build -b chipyard_pynqz1_micrgb samples/vision_replay \
#       -- -DBOARD_ROOT=$IISWC_ROOT -DMODEL_DIR=<out>/gen -DFRAMES_DIR=<out>/frames
#
# Two generated inputs, and they must agree about the architecture: MODEL_DIR is a
# ModelBlaster pext build of vww_<arch>, FRAMES_DIR is gen_replay_frames.py's output for
# the SAME arch.  The build checks that below rather than trusting the caller, because
# feeding a mono feature to the Bayer model still runs, still prints a class, and is
# wrong -- the same shape of bug SPEECH_ON_ROCKET.md section 9 item 15 records.

cmake_minimum_required(VERSION 3.20.0)

foreach(_v MODEL_DIR FRAMES_DIR)
    if(NOT DEFINED ${_v})
        message(FATAL_ERROR "${_v} not set.")
    endif()
    get_filename_component(${_v} "${${_v}}" ABSOLUTE)
    if(NOT IS_DIRECTORY "${${_v}}")
        message(FATAL_ERROR "${_v}='${${_v}}' is not a directory.")
    endif()
endforeach()

get_filename_component(SW_DIR "${CMAKE_CURRENT_SOURCE_DIR}/../../fpga/pynq-z2/sw" ABSOLUTE)
if(NOT EXISTS "${SW_DIR}/frame_fe.c")
    message(FATAL_ERROR "frame_fe.c not found at ${SW_DIR}")
endif()

find_package(Zephyr REQUIRED HINTS $ENV{ZEPHYR_BASE})
project(vision_replay)

foreach(_required model.c model.h kernels.c kernels.h weights.c weights.h
                  buffers.c test_io.h test_io.S test_input.bin test_golden.bin)
    if(NOT EXISTS "${MODEL_DIR}/${_required}")
        message(FATAL_ERROR "MODEL_DIR='${MODEL_DIR}' is missing ${_required}.")
    endif()
endforeach()
foreach(_required replay_frames.c replay_frames.h replay_frames.json)
    if(NOT EXISTS "${FRAMES_DIR}/${_required}")
        message(FATAL_ERROR "FRAMES_DIR='${FRAMES_DIR}' is missing ${_required}.")
    endif()
endforeach()

# The two generated trees must name the same architecture. VR_ARCH comes from the frame
# generator; MODEL_NAME from the codegen. A mismatch is a silent wrong answer.
file(READ "${FRAMES_DIR}/replay_frames.h" _fh)
string(REGEX MATCH "#define VR_ARCH[ \t]+\"([a-z0-9_]+)\"" _m "${_fh}")
set(_frames_arch "${CMAKE_MATCH_1}")
file(READ "${MODEL_DIR}/model.h" _mh)
string(REGEX MATCH "#define MODEL_[A-Z0-9_]*NAME[ \t]+\"vww_([a-z0-9_]+)\"" _m2 "${_mh}")
set(_model_arch "${CMAKE_MATCH_1}")
if(NOT _frames_arch STREQUAL _model_arch)
    message(FATAL_ERROR
        "architecture mismatch: FRAMES_DIR is for '${_frames_arch}' and MODEL_DIR is "
        "for '${_model_arch}'. Feeding one model another's feature tensor still runs.")
endif()
message(STATUS "vision_replay arch=${_model_arch}")

target_sources(app PRIVATE
    src/main.c
    ${SW_DIR}/frame_fe.c
    ${FRAMES_DIR}/replay_frames.c
    ${MODEL_DIR}/model.c
    ${MODEL_DIR}/kernels.c
    ${MODEL_DIR}/weights.c
    ${MODEL_DIR}/buffers.c
    ${MODEL_DIR}/test_io.S
)
set_source_files_properties(${MODEL_DIR}/test_io.S PROPERTIES LANGUAGE ASM)
target_include_directories(app PRIVATE src ${MODEL_DIR} ${FRAMES_DIR} ${SW_DIR})

if(DEFINED MODELBLASTER_KERNEL_CFLAGS)
    separate_arguments(_mb_kernel_cflags NATIVE_COMMAND "${MODELBLASTER_KERNEL_CFLAGS}")
    set_source_files_properties(${MODEL_DIR}/kernels.c PROPERTIES
        COMPILE_OPTIONS "${_mb_kernel_cflags}")
endif()

# Same reason as every other ModelBlaster sample here: the packed int8 weight arrays push
# .sdata past the +/-2 KB window the linker folds into gp-relative loads, and the link
# fails with "relocation truncated to fit". medany still reaches +/-2 GB.
zephyr_link_libraries(-Wl,--no-relax)
```

## Kconfig
```
# SPDX-License-Identifier: Apache-2.0
#
# PEXT_SPEC.md section 7.2's build-time layer of the heterogeneity contract, spelled
# the way it asks for: one Kconfig symbol, one image, both behaviours.
#
# CONFIG_MB_PEXT=y makes fpga/pynq-z2/sw/pext.h emit the real custom-0 encodings; with
# it off, the identical sources compile against the header's bit-identical software
# model and run anywhere, including the LITTLE hart, spike and the build host.  The
# header reads CONFIG_MB_PEXT directly (Zephyr puts autoconf.h in front of every
# translation unit), so nothing else has to be wired up for this to take effect in the
# generated kernels.c.

mainmenu "Camera path: frame_fe + a ModelBlaster network"

config MB_PEXT
	bool "Build the ModelBlaster kernels against the MBP extension"
	default y
	help
	  Emit the real MBP.DOT8 / MBP.MAX8 / MBP.QMUL / MBP.CLIP8 encodings
	  (custom-0, opcode 0x0b) instead of pext.h's software model.

	  THE EXTENSION EXISTS ON HART 0 ONLY.  With this enabled, any thread
	  that reaches a curated pext kernel MUST be pinned to CPU 0 with
	  k_thread_cpu_pin(), or it takes an illegal-instruction trap.  That is
	  the intended behaviour and this sample tests for it deliberately;
	  see PEXT_SPEC.md section 7.

	  Turn this off to build the same image against the software model --
	  useful for bring-up on a bitstream that does not yet carry the
	  extension, and far slower than the plain scalar reference kernels, so
	  not a production configuration.

source "Kconfig.zephyr"
```

## prj.conf
```kconfig
# The extension, on. This is what makes pext.h emit real custom-0 encodings in the
# generated kernels.c (see Kconfig).
CONFIG_MB_PEXT=y

# Two harts, and the ability to put a thread on the one we name. CONFIG_SCHED_CPU_MASK
# is what k_thread_cpu_pin() needs to exist at all, and pinning is the ENTIRE
# heterogeneity mechanism here (PEXT_SPEC.md section 7.3): the MBP instructions are on
# hart 0 only, so a kernel that lands on hart 1 traps.
CONFIG_SMP=y
CONFIG_MP_MAX_NUM_CPUS=2
CONFIG_SCHED_CPU_MASK=y

# NO FLOATING POINT ANYWHERE.
#
# The SoC is WithoutFPU: riscv,isa = "rv64imaczicsr_zifencei_zihpm_xrocket" for BOTH
# harts -- no f, no d, no v. Any float in the image either traps as illegal (hard float)
# or turns into libgcc soft-float calls that would dominate whatever is being measured.
# The board defconfig already sets CONFIG_FPU=n; this repeats it because an app prj.conf
# overrides the board and modelblaster's own harness prj.conf sets CONFIG_FPU=y, so the
# value has to be stated here rather than inherited.
CONFIG_FPU=n
CONFIG_CBPRINTF_FP_SUPPORT=n

CONFIG_PRINTK=y

# The negative test deliberately takes an illegal-instruction trap on hart 1 and
# survives it: the app overrides k_sys_fatal_error_handler to abort just the offending
# thread. The exception path has to be able to print before that happens, which is what
# these two buy. Without the k_sys_fatal_error_handler override the __weak default
# halts the system and the test reports nothing at all.
CONFIG_EXCEPTION_DEBUG=y
CONFIG_THREAD_NAME=y

# The generated model keeps its intermediate tensors in static buffers (buffers.c) and
# the curated kernels keep their scratch in .bss, so the per-inference stack is small.
# These are sized for headroom, not need.
CONFIG_MAIN_STACK_SIZE=16384
CONFIG_ISR_STACK_SIZE=4096

# Timeslicing off: exactly one worker is runnable at a time and it is pinned, so slicing
# can only add noise to the cycle counts.
CONFIG_TIMESLICING=n

# The replayed frames are 324x324 bytes each and there are several of them, plus the
# feature goldens: over a megabyte of .rodata. Nothing here needs a bigger stack than
# the model does -- the front-end outputs are file-static for exactly that reason -- but
# the main stack carries the per-frame bookkeeping.
CONFIG_MAIN_STACK_SIZE=32768
```

## src/main.c
```c
/*
 * SPDX-License-Identifier: Apache-2.0
 *
 * The whole camera path on one hart: a 324x324 frame sitting in DRAM, the front end,
 * the network, an answer -- timed stage by stage.
 *
 * WHY THE FRAMES ARE REPLAYED FROM DRAM RATHER THAN CAPTURED.  A measurement wants the
 * same input every time, and a sensor pointed at a room does not give one.  The frames
 * here are held-out Visual Wake Words images synthesised to 324x324 and baked into
 * .rodata by fpga/pynq-z2/sw/tools/gen_replay_frames.py, so they sit in DDR exactly
 * where the capture DMA would leave them and every stage downstream of the pixel is the
 * real one.  Lab B17 fed the speech models stored features for the same reason, and that
 * is what makes its cycle counts reproduce to 0.00 % of the median.
 *
 * FOUR THINGS ARE MEASURED AND ONE IS CHECKED.
 *
 *   1. All THREE front ends on every frame -- monochrome, demosaiced colour, and raw
 *      Bayer -- from the two sensor frames the image carries.  The sensor sends 104,976
 *      bytes either way; the difference between these three numbers is what colour
 *      actually costs on this core, and it is the answer to a question that is otherwise
 *      argued rather than measured.
 *
 *   2. The model, on the feature this build's architecture takes.
 *
 *   3. End to end: front end + model, per frame, as frames per second.
 *
 *   4. CHECKED: the device's feature against the one the HOST build of the same
 *      frame_fe.c produced, element by element.  max_abs_err must be 0.  This is the
 *      model's baked-golden gate applied one stage earlier, and it is what would catch a
 *      front end that is subtly different on the target -- a shift that is arithmetic on
 *      one side and logical on the other, an integer promotion, a different rounding.
 *      A wrong front end produces a plausible classification and a believable cycle
 *      count, which is exactly the failure this repo has been bitten by before.
 *
 * Pinned to CPU 0, which is the hart with MBP.  Interrupts are locked around every timed
 * window.  Everything printed is integer; no float appears in this image.
 */

#include <zephyr/kernel.h>
#include <zephyr/arch/cpu.h>
#include <zephyr/sys/printk.h>
#include <zephyr/arch/riscv/csr.h>

#include "pext.h"
#include "frame_fe.h"
#include "replay_frames.h"
#include "model.h"
#include "test_io.h"

#define WORKER_STACK   16384
#define BIG_CPU        0

K_THREAD_STACK_DEFINE(big_stack, WORKER_STACK);
static struct k_thread big_thread;
static K_SEM_DEFINE(done_sem, 0, 1);

/* Front-end outputs.  Static, not stack: 3 x 96 x 96 is 27 KB and the thread stack is
 * not the place for it. */
static int8_t fe_mono[FE_MONO_ELEMS];
static int8_t fe_rgb[FE_RGB_ELEMS];
static int8_t fe_bay[FE_BAYER_ELEMS];
static model_output_t out_buf[MODEL_OUTPUT_SIZE];

static struct {
	unsigned long fe_mono_cyc[VR_NFRAMES];
	unsigned long fe_rgb_cyc[VR_NFRAMES];
	unsigned long fe_bay_cyc[VR_NFRAMES];
	unsigned long model_cyc[VR_NFRAMES];
	int           feat_err[VR_NFRAMES];
	int           pred[VR_NFRAMES];
	int           golden_err;
	int           selftest;
	int           correct;
	unsigned int  cpu_id, hartid;
	bool          ran;
} R;

static inline unsigned long rdcycle(void)
{
	unsigned long c;

	__asm__ volatile("rdcycle %0" : "=r"(c));
	return c;
}

static unsigned long median_ul(const unsigned long *a, int n)
{
	unsigned long t[VR_NFRAMES];
	int i, j;

	for (i = 0; i < n; i++) {
		t[i] = a[i];
	}
	for (i = 1; i < n; i++) {
		unsigned long v = t[i];

		j = i - 1;
		while (j >= 0 && t[j] > v) {
			t[j + 1] = t[j];
			j--;
		}
		t[j + 1] = v;
	}
	return t[n / 2];
}

static const int8_t *feat_for_build(void)
{
#if VR_FEED == 0
	return fe_mono;
#elif VR_FEED == 1
	return fe_rgb;
#else
	return fe_bay;
#endif
}

static void worker(void *p1, void *p2, void *p3)
{
	int f, i;

	ARG_UNUSED(p1); ARG_UNUSED(p2); ARG_UNUSED(p3);
	R.cpu_id = arch_curr_cpu()->id;
	R.hartid = csr_read(mhartid);
	R.ran = true;
	MB_PEXT_ASSERT_BIG_HART();

	R.selftest = frame_fe_selftest();

	/* The model against its own baked int8 golden, before any frame is touched.
	 * Without this, "the demo classified something" is compatible with a stale
	 * MODEL_DIR or a curated kernel that silently fell back. */
	model_run_test(out_buf, NULL);
	R.golden_err = 0;
	for (i = 0; i < MODEL_TEST_OUTPUT_LEN; i++) {
		int d = (int)out_buf[i] - (int)model_test_golden[i];

		if (d < 0) {
			d = -d;
		}
		if (d > R.golden_err) {
			R.golden_err = d;
		}
	}

	R.correct = 0;
	for (f = 0; f < VR_NFRAMES; f++) {
		const uint8_t *mono = vr_mono_frame + (size_t)f * FRAME_BYTES;
		const uint8_t *bay  = vr_bayer_frame + (size_t)f * FRAME_BYTES;
		const int8_t *gold  = vr_feat_golden + (size_t)f * VR_FEAT_ELEMS;
		const int8_t *feat;
		unsigned long a, b;
		unsigned int key;
		int best, bi;

		key = irq_lock();
		a = rdcycle(); frame_fe_mono96(mono, fe_mono);     b = rdcycle();
		R.fe_mono_cyc[f] = b - a;
		a = rdcycle(); frame_fe_rgb96(bay, fe_rgb);        b = rdcycle();
		R.fe_rgb_cyc[f] = b - a;
		a = rdcycle(); frame_fe_bayer4_48(bay, fe_bay);    b = rdcycle();
		R.fe_bay_cyc[f] = b - a;
		irq_unlock(key);

		feat = feat_for_build();
		R.feat_err[f] = 0;
		for (i = 0; i < VR_FEAT_ELEMS; i++) {
			int d = (int)feat[i] - (int)gold[i];

			if (d < 0) {
				d = -d;
			}
			if (d > R.feat_err[f]) {
				R.feat_err[f] = d;
			}
		}

		key = irq_lock();
		a = rdcycle();
		run_model(feat, out_buf, NULL);
		b = rdcycle();
		irq_unlock(key);
		R.model_cyc[f] = b - a;

		best = -32768; bi = 0;
		for (i = 0; i < MODEL_OUTPUT_SIZE; i++) {
			if ((int)out_buf[i] > best) {
				best = (int)out_buf[i];
				bi = i;
			}
		}
		R.pred[f] = bi;
		if (bi == (int)vr_label[f]) {
			R.correct++;
		}
	}
	k_sem_give(&done_sem);
}

int main(void)
{
	unsigned long fem, fer, feb, mm, tot;
	int f, bad = 0;

	printk("\nVISION_REPLAY arch=%s feed=%s model=%s frames=%d feat_elems=%d "
	       "frame_bytes=%d pext=%d\n",
	       VR_ARCH, VR_FEED_NAME, MODEL_NAME, VR_NFRAMES, VR_FEAT_ELEMS,
	       FRAME_BYTES, frame_fe_uses_pext());

	k_thread_create(&big_thread, big_stack, WORKER_STACK, worker,
			NULL, NULL, NULL, 5, 0, K_FOREVER);
	k_thread_cpu_pin(&big_thread, BIG_CPU);
	k_thread_name_set(&big_thread, "replay");
	k_thread_start(&big_thread);
	if (k_sem_take(&done_sem, K_SECONDS(300)) != 0) {
		printk("FAIL: the worker did not finish\n");
		return 1;
	}

	printk("VR_ENV cpu=%u mhartid=%u selftest=%d golden_max_abs_err=%d\n",
	       R.cpu_id, R.hartid, R.selftest, R.golden_err);
	if (R.selftest != 0) {
		printk("FAIL: frame_fe_selftest returned %d\n", R.selftest);
		bad++;
	}
	if (R.golden_err != 0) {
		printk("FAIL: model max_abs_err=%d against the baked int8 golden\n",
		       R.golden_err);
		bad++;
	}

	for (f = 0; f < VR_NFRAMES; f++) {
		printk("VR_FRAME i=%d fe_mono=%lu fe_rgb=%lu fe_bayer=%lu model=%lu "
		       "feat_max_abs_err=%d pred=%s label=%s\n",
		       f, R.fe_mono_cyc[f], R.fe_rgb_cyc[f], R.fe_bay_cyc[f],
		       R.model_cyc[f], R.feat_err[f],
		       vr_label_name[R.pred[f]], vr_label_name[vr_label[f]]);
		if (R.feat_err[f] != 0) {
			bad++;
		}
	}

	fem = median_ul(R.fe_mono_cyc, VR_NFRAMES);
	fer = median_ul(R.fe_rgb_cyc, VR_NFRAMES);
	feb = median_ul(R.fe_bay_cyc, VR_NFRAMES);
	mm  = median_ul(R.model_cyc, VR_NFRAMES);
	tot = mm + (VR_FEED == 0 ? fem : (VR_FEED == 1 ? fer : feb));

	printk("VR_MEDIAN fe_mono=%lu fe_rgb=%lu fe_bayer=%lu model=%lu end_to_end=%lu\n",
	       fem, fer, feb, mm, tot);
	printk("VR_ACC correct=%d of=%d\n", R.correct, VR_NFRAMES);
	printk("VISION_REPLAY: %s\n", bad ? "FAIL" : "PASS");
	return bad ? 1 : 0;
}
```
