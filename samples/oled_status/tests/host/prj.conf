## CMakeLists.txt
```
# SPDX-License-Identifier: Apache-2.0
#
# Host test for samples/oled_status on native_sim/native/64:
#   the stock ssd1306 driver + CFB + src/oled_status.c, over Zephyr's I2C emulator, into
#   model/ssd1306_model.c. Asserts the init sequence against the datasheet and dumps the
#   rendered GDDRAM so scripts/54_oled_host_tests.sh can hash it against
#   expected/oled_status.json. The overlay is the sample's own oled.overlay: native_sim's
#   I2C emulator controller is also labelled i2c0.
cmake_minimum_required(VERSION 3.20.0)

set(EXTRA_DTC_OVERLAY_FILE ${CMAKE_CURRENT_SOURCE_DIR}/../../oled.overlay)
find_package(Zephyr REQUIRED HINTS $ENV{ZEPHYR_BASE})
project(oled_status_host_test)

set(S ${CMAKE_CURRENT_SOURCE_DIR}/../..)
target_include_directories(app PRIVATE ${S}/src ${S}/model)
target_sources(app PRIVATE
  src/test_oled.c
  src/ssd1306_emul.c
  ${S}/src/oled_status.c
  ${S}/src/font5x8.c
  ${S}/model/ssd1306_model.c)
```

## Kconfig
```
# SPDX-License-Identifier: Apache-2.0
mainmenu "oled_status host test"

rsource "../../src/Kconfig.oled_status"

config OLED_TEST_ABSENT
	bool "Neither emulated display ACKs (module not fitted)"
	help
	  Built as a separate image by scripts/54_oled_host_tests.sh: oled_status's probe is
	  one-shot, so "absent" cannot share a binary with "present".

source "Kconfig.zephyr"
```

## prj.conf
```kconfig
# SPDX-License-Identifier: Apache-2.0
CONFIG_ZTEST=y
CONFIG_EMUL=y
CONFIG_I2C=y
CONFIG_DISPLAY=y
CONFIG_CHARACTER_FRAMEBUFFER=y
CONFIG_CHARACTER_FRAMEBUFFER_USE_DEFAULT_FONTS=n
CONFIG_HEAP_MEM_POOL_SIZE=4096
CONFIG_MAIN_STACK_SIZE=4096
CONFIG_ZTEST_STACK_SIZE=8192
# The rate limit is exercised by the demo; here each post should draw promptly.
CONFIG_OLED_STATUS_PERIOD_MS=10
# Every PGMHEX line must reach the console: no deferred-log drops.
CONFIG_LOG_MODE_IMMEDIATE=y
```

## src/ssd1306_emul.c
```c
/* SPDX-License-Identifier: Apache-2.0 */
/*
 * Zephyr I2C emulator for the SSD1306 nodes, backed by model/ssd1306_model.c.
 *
 * The emulated controller hands the target a whole i2c_msg array. What that array looks
 * like ON THE WIRE is a property of the controller driver, so the translation into
 * START / byte / STOP events is selectable:
 *
 *   SSD1306_EMUL_WIRE_CONTRACT  the Zephyr I2C API contract: an address phase only at the
 *        start of a transfer, after a STOP, on I2C_MSG_RESTART, or on a change of direction
 *        (the rule i2c_bitbang.c and i2c_dw.c implement). i2c_burst_write() is one transfer.
 *
 *   SSD1306_EMUL_WIRE_STOCK_SIFIVE  a transcription of the stock i2c_sifive.c: START +
 *        address for every message, STOP only after the last byte of a message flagged
 *        I2C_MSG_STOP, no STOP after a NACK. This is a MODEL OF A READING of that driver,
 *        used as the negative control for the golden comparison; whether the real driver
 *        on the real TLI2C does this is settled by the RTL test (OLED_SSD1306.md P2), not
 *        here.
 */
#define DT_DRV_COMPAT solomon_ssd1306fb

#include <errno.h>
#include <zephyr/device.h>
#include <zephyr/drivers/emul.h>
#include <zephyr/drivers/i2c.h>
#include <zephyr/drivers/i2c_emul.h>

#include "ssd1306_emul.h"

struct ssd1306_emul_data {
	struct ssd1306_model m;
	bool bus_busy; /* a START has been sent without a STOP (stock mode) */
};

static enum ssd1306_emul_wire wire_mode = SSD1306_EMUL_WIRE_CONTRACT;

void ssd1306_emul_set_wire(enum ssd1306_emul_wire w)
{
	wire_mode = w;
}

static int xfer_contract(struct ssd1306_emul_data *d, struct i2c_msg *msgs, int n, int addr)
{
	struct ssd1306_model *m = &d->m;
	bool in_xfer = false;
	int prev_rw = -1;

	for (int i = 0; i < n; i++) {
		int rw = msgs[i].flags & I2C_MSG_READ;

		if (!in_xfer || (msgs[i].flags & I2C_MSG_RESTART) || rw != prev_rw) {
			ssd1306_model_start(m, in_xfer);
			if (!ssd1306_model_byte(m, (uint8_t)((addr << 1) | rw))) {
				ssd1306_model_stop(m);
				return -EIO;
			}
		}
		if (rw) {
			ssd1306_model_stop(m);
			return -EIO; /* the SSD1306 has no read path */
		}
		for (uint32_t j = 0; j < msgs[i].len; j++) {
			if (!ssd1306_model_byte(m, msgs[i].buf[j])) {
				ssd1306_model_stop(m);
				return -EIO;
			}
		}
		if (msgs[i].flags & I2C_MSG_STOP) {
			ssd1306_model_stop(m);
			in_xfer = false;
		} else {
			in_xfer = true;
		}
		prev_rw = rw;
	}
	return 0;
}

static int xfer_stock_sifive(struct ssd1306_emul_data *d, struct i2c_msg *msgs, int n, int addr)
{
	struct ssd1306_model *m = &d->m;

	for (int i = 0; i < n; i++) {
		int rw = msgs[i].flags & I2C_MSG_READ;

		ssd1306_model_start(m, d->bus_busy);
		d->bus_busy = true;
		if (!ssd1306_model_byte(m, (uint8_t)((addr << 1) | rw))) {
			return -EIO; /* i2c_sifive_send_addr: return without STOP */
		}
		if (rw) {
			return -EIO;
		}
		for (uint32_t j = 0; j < msgs[i].len; j++) {
			bool ack = ssd1306_model_byte(m, msgs[i].buf[j]);

			if (j == msgs[i].len - 1 && (msgs[i].flags & I2C_MSG_STOP)) {
				ssd1306_model_stop(m);
				d->bus_busy = false;
			}
			if (!ack) {
				return -EIO;
			}
		}
	}
	return 0;
}

static int ssd1306_emul_transfer(const struct emul *target, struct i2c_msg *msgs, int num_msgs,
				 int addr)
{
	struct ssd1306_emul_data *d = target->data;

	if (wire_mode == SSD1306_EMUL_WIRE_STOCK_SIFIVE) {
		return xfer_stock_sifive(d, msgs, num_msgs, addr);
	}
	return xfer_contract(d, msgs, num_msgs, addr);
}

static const struct i2c_emul_api ssd1306_emul_bus_api = {
	.transfer = ssd1306_emul_transfer,
};

static int ssd1306_emul_init(const struct emul *target, const struct device *parent)
{
	struct ssd1306_emul_data *d = target->data;
	uint16_t addr = target->bus.i2c->addr;
	bool present = (addr == 0x3c) && !IS_ENABLED(CONFIG_OLED_TEST_ABSENT);

	ARG_UNUSED(parent);
	ssd1306_model_init(&d->m, addr, present);
	return 0;
}

#define SSD1306_EMUL(n)                                                                    \
	static struct ssd1306_emul_data ssd1306_emul_data_##n;                              \
	EMUL_DT_INST_DEFINE(n, ssd1306_emul_init, &ssd1306_emul_data_##n, NULL,             \
			    &ssd1306_emul_bus_api, NULL)

DT_INST_FOREACH_STATUS_OKAY(SSD1306_EMUL)

struct ssd1306_model *ssd1306_emul_model(uint16_t addr)
{
#define SSD1306_EMUL_MATCH(n)                                                              \
	if (DT_INST_REG_ADDR(n) == addr) {                                                  \
		return &ssd1306_emul_data_##n.m;                                            \
	}
	DT_INST_FOREACH_STATUS_OKAY(SSD1306_EMUL_MATCH)
	return NULL;
}
```

## src/ssd1306_emul.h
```c
/* SPDX-License-Identifier: Apache-2.0 */
#ifndef SSD1306_EMUL_H_
#define SSD1306_EMUL_H_

#include <stdint.h>
#include "ssd1306_model.h"

enum ssd1306_emul_wire {
	SSD1306_EMUL_WIRE_CONTRACT,
	SSD1306_EMUL_WIRE_STOCK_SIFIVE,
};

void ssd1306_emul_set_wire(enum ssd1306_emul_wire w);
struct ssd1306_model *ssd1306_emul_model(uint16_t addr);

#endif
```

## src/test_oled.c
```c
/* SPDX-License-Identifier: Apache-2.0 */
/*
 * Host test: samples/oled_status on the stock ssd1306 driver and CFB, over Zephyr's I2C
 * emulator, into the behavioural SSD1306 model. See fpga/pynq-z2/docs/OLED_SSD1306.md
 * sections 5.2 (the init sequence) and 7 (results).
 *
 * The rendered images are not compared here. They are dumped as
 *     PGMHEX <name> <offset> <hex bytes>
 * lines, and scripts/54_oled_host_tests.sh rebuilds the PGM files, hashes them and compares
 * the hashes with expected/oled_status.json. The RTL simulation's model writes the same
 * PGM, so one golden serves both.
 */
#include <string.h>
#include <zephyr/display/cfb.h>
#include <zephyr/drivers/display.h>
#include <zephyr/kernel.h>
#include <zephyr/sys/printk.h>
#include <zephyr/ztest.h>

#include "oled_golden.h"
#include "oled_status.h"
#include "ssd1306_emul.h"

static uint8_t pgm[16 + SSD1306_MODEL_W * SSD1306_MODEL_H];

static void dump_pgm(const char *name, const struct ssd1306_model *m)
{
	size_t n = ssd1306_model_pgm(m, pgm, sizeof(pgm));

	zassert_true(n > 0, "pgm buffer too small");
	for (size_t off = 0; off < n; off += 64) {
		printk("PGMHEX %s %zu ", name, off);
		for (size_t i = off; i < n && i < off + 64; i++) {
			printk("%02x", pgm[i]);
		}
		printk("\n");
	}
}

static void dump_wire(const char *name, const struct ssd1306_model *m)
{
	/* printk has a line limit; emit the log a line at a time */
	const char *p = m->log;

	while (*p) {
		const char *e = strchr(p, '\n');
		size_t len = e ? (size_t)(e - p) : strlen(p);

		/* long transfers go out in 240-character pieces; "WIRE+" continues a line */
		for (size_t off = 0; off < len; off += 240) {
			char piece[241];
			size_t n = MIN(len - off, 240);

			/* copy: a %.*s argument is still packaged whole by deferred printk */
			memcpy(piece, p + off, n);
			piece[n] = '\0';
			printk("WIRE%s %s %s\n", off ? "+" : "", name, piece);
		}
		p += len + (e ? 1 : 0);
	}
}

static bool wait_state(enum oled_state want, uint32_t drawn, int ms)
{
	for (int i = 0; i < ms; i++) {
		if (oled_status_state() == want && oled_status_frames_drawn() >= drawn) {
			return true;
		}
		k_msleep(1);
	}
	return false;
}

/* The exact command bytes of probe + ssd1306_init_device(), from the driver source. */
static const uint8_t expected_init_cmds[] = {
	0xe3,                                     /* our probe: NOP */
	0xae,                                     /* display off */
	0xd5, 0x80, 0xd9, 0x22, 0xdb, 0x20,       /* clock, precharge, VCOMH */
	0x40, 0xd3, 0x00, 0xda, 0x12, 0xa8, 0x3f, /* start line, offset, COM pins, mux */
	0xa1, 0xc8,                               /* segment remap, COM scan flipped */
	0x8d, 0x14, 0x33,                         /* charge pump on, then 0x33 */
	0xa4, 0xa6,                               /* RAM content, normal */
	0x81, 0x80,                               /* contrast 128 */
	0xaf,                                     /* display on */
};

static const uint8_t expected_window[] = {0x20, 0x00, 0x21, 0x00, 0x7f, 0x22, 0x00, 0x07};

#if !defined(CONFIG_OLED_TEST_ABSENT)

ZTEST(oled_present, test_01_probe_and_init_sequence)
{
	struct ssd1306_model *m = ssd1306_emul_model(0x3c);
	int pump = -1, on = -1;

	zassert_not_null(m);
	ssd1306_emul_set_wire(SSD1306_EMUL_WIRE_CONTRACT);
	zassert_ok(oled_status_start());
	zassert_true(wait_state(OLED_STATE_READY, 0, 2000), "state %s",
		     oled_state_name(oled_status_state()));
	zassert_equal(oled_status_addr(), 0x3c);
	dump_wire("init", m);

	zassert_equal(m->n_cmds_kept, sizeof(expected_init_cmds), "got %zu command bytes",
		      m->n_cmds_kept);
	zassert_mem_equal(m->cmds, expected_init_cmds, sizeof(expected_init_cmds));

	/* datasheet ordering, asserted independently of the exact list */
	for (size_t i = 0; i + 1 < m->n_cmds_kept; i++) {
		if (m->cmds[i] == 0x8d && m->cmds[i + 1] == 0x14 && pump < 0) {
			pump = (int)i;
		}
	}
	for (size_t i = 0; i < m->n_cmds_kept; i++) {
		if (m->cmds[i] == 0xaf) {
			on = (int)i;
		}
	}
	zassert_true(pump >= 0, "charge pump 8D 14 never sent");
	zassert_true(on > pump, "display on (AF) must follow 8D 14");
	zassert_equal(on, (int)m->n_cmds_kept - 1, "AF must be the last init command");
	zassert_equal(m->cmds[1], 0xae, "init must start with the panel off");
	zassert_false(m->pump_before_on_violation);
	zassert_true(m->display_on && m->charge_pump);
	zassert_equal(m->mux, 63);
	zassert_equal(m->com_pins, 0x12, "128x64 panels use alternative COM pins");
	zassert_equal(m->n_bad_ctrl, 0);
	zassert_equal(m->n_restart, 0, "API-contract wire: no repeated START");
	zassert_equal(m->n_start, m->n_stop, "every transfer closed");
	zassert_equal(m->n_unknown_cmds, 1, "exactly one unassigned code: the 0x33 after 8D 14");
	zassert_equal(m->n_data_bytes, 0);
}

ZTEST(oled_present, test_02_golden_status_screen)
{
	struct ssd1306_model *m = ssd1306_emul_model(0x3c);
	size_t cmds_before = m->n_cmds_kept;
	uint32_t drawn = oled_status_frames_drawn();

	m->log_len = 0;
	m->log[0] = '\0';
	oled_status_post(&oled_golden_status);
	zassert_true(wait_state(OLED_STATE_READY, drawn + 1, 2000));

	/* addressing mode + window before the data, then exactly one frame of GDDRAM */
	zassert_equal(m->n_cmds_kept - cmds_before, sizeof(expected_window));
	zassert_mem_equal(m->cmds + cmds_before, expected_window, sizeof(expected_window));
	zassert_equal(m->mode, 0, "horizontal addressing");
	zassert_equal(m->n_data_bytes, 1024);
	zassert_equal(m->n_restart, 0);
	zassert_equal(m->n_bad_ctrl, 0);
	dump_pgm("status", m);
}

ZTEST(oled_present, test_03_golden_test_pattern)
{
	struct ssd1306_model *m = ssd1306_emul_model(0x3c);
	uint32_t drawn = oled_status_frames_drawn();

	oled_status_post_pattern();
	zassert_true(wait_state(OLED_STATE_READY, drawn + 1, 2000));
	zassert_equal(m->n_data_bytes, 2048);
	/* the border is lit on all four edges */
	zassert_true(ssd1306_model_pixel(m, 0, 0) && ssd1306_model_pixel(m, 127, 63));
	zassert_true(ssd1306_model_pixel(m, 64, 0) && ssd1306_model_pixel(m, 0, 32));
	dump_pgm("pattern", m);
}

ZTEST(oled_present, test_04_bar_graph_geometry)
{
	struct ssd1306_model *m = ssd1306_emul_model(0x3c);
	const struct device *disp = DEVICE_DT_GET(DT_NODELABEL(oled_3c));
	static const uint32_t vals[] = {0, 25, 100, 150};
	static const int fill_px[] = {0, 31, 124, 124}; /* (128-4) * v / 100, clamped */

	for (size_t k = 0; k < ARRAY_SIZE(vals); k++) {
		int lit = 0;

		zassert_ok(cfb_framebuffer_clear(disp, false));
		zassert_ok(oled_bar(disp, 0, 8, 128, 8, vals[k], 100));
		oled_status_bus_lock();
		zassert_ok(cfb_framebuffer_finalize(disp));
		oled_status_bus_unlock();
		/* outline: rows 8 and 15, columns 0 and 127 */
		zassert_true(ssd1306_model_pixel(m, 0, 8) && ssd1306_model_pixel(m, 127, 15));
		zassert_true(ssd1306_model_pixel(m, 0, 12) && ssd1306_model_pixel(m, 127, 12));
		/* 1-pixel gap inside the outline */
		zassert_false(ssd1306_model_pixel(m, 1, 12));
		zassert_false(ssd1306_model_pixel(m, 60, 9));
		/* fill row 12, columns 2..125 */
		for (int x = 2; x < 126; x++) {
			lit += ssd1306_model_pixel(m, x, 12);
		}
		zassert_equal(lit, fill_px[k], "value %u: %d px lit", vals[k], lit);
		/* nothing outside the bar */
		zassert_false(ssd1306_model_pixel(m, 10, 7) || ssd1306_model_pixel(m, 10, 16));
	}
	zassert_equal(oled_bar(disp, 0, 0, 4, 8, 1, 2), -EINVAL);
	zassert_equal(oled_bar(disp, 0, 0, 8, 8, 1, 0), -EINVAL);
}

ZTEST(oled_present, test_05_post_never_blocks)
{
	/* A burst of posts while refreshes run: each returns without waiting for the bus. */
	struct oled_status s = oled_golden_status;
	int64_t t0 = k_uptime_ticks();

	oled_status_bus_lock(); /* hold the bus: a blocking post would deadlock here */
	for (int i = 0; i < 1000; i++) {
		s.frame = i;
		oled_status_post(&s);
	}
	oled_status_bus_unlock();
	zassert_true(k_uptime_ticks() - t0 <= 1, "posting took %lld ticks",
		     k_uptime_ticks() - t0);
}

/*
 * Negative control for the golden comparison: the same screen through a wire model of the
 * stock i2c_sifive reading (a repeated START before every payload) must NOT reproduce the
 * golden. Run last: it leaves the model's panel state scrambled.
 */
ZTEST(oled_present, test_99_stock_sifive_wire_negative_control)
{
	struct ssd1306_model *m = ssd1306_emul_model(0x3c);
	const struct device *disp = DEVICE_DT_GET(DT_NODELABEL(oled_3c));
	unsigned long restarts = m->n_restart;

	zassert_ok(oled_status_render(disp, &oled_golden_status));
	ssd1306_emul_set_wire(SSD1306_EMUL_WIRE_STOCK_SIFIVE);
	m->log_len = 0;
	m->log[0] = '\0';
	oled_status_bus_lock();
	(void)cfb_framebuffer_finalize(disp);
	oled_status_bus_unlock();
	ssd1306_emul_set_wire(SSD1306_EMUL_WIRE_CONTRACT);
	dump_wire("stock", m);
	zassert_true(m->n_restart > restarts, "stock wire model sends Sr before each payload");
	dump_pgm("stock_status", m);
}

ZTEST_SUITE(oled_present, NULL, NULL, NULL, NULL, NULL);

#else /* CONFIG_OLED_TEST_ABSENT */

ZTEST(oled_absent, test_01_absent_is_not_fitted_and_nothing_blocks)
{
	struct ssd1306_model *m3c = ssd1306_emul_model(0x3c);
	struct ssd1306_model *m3d = ssd1306_emul_model(0x3d);
	struct oled_status s = oled_golden_status;

	zassert_ok(oled_status_start());
	zassert_true(wait_state(OLED_STATE_ABSENT, 0, 2000), "state %s",
		     oled_state_name(oled_status_state()));
	zassert_equal(oled_status_addr(), 0);
	/* exactly one probe per address, and the bus left alone afterwards */
	zassert_equal(m3c->n_addr_nack, 1);
	zassert_equal(m3d->n_addr_nack, 1);
	for (int i = 0; i < 100; i++) {
		s.frame = i;
		oled_status_post(&s);
	}
	k_msleep(100);
	zassert_equal(m3c->n_start + m3d->n_start, 2, "no bus traffic after 'not fitted'");
	zassert_equal(oled_status_frames_drawn(), 0);
	zassert_equal(oled_status_start(), -EALREADY);
}

ZTEST_SUITE(oled_absent, NULL, NULL, NULL, NULL, NULL);

#endif
```
