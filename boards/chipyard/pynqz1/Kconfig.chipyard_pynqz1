## boards/chipyard/pynqz1/board.yml
```yaml
board:
  name: chipyard_pynqz1
  full_name: Chipyard Rocket + TACIT on PYNQ-Z1
  vendor: chipyard
  socs:
    - name: rocketchip_virt_riscv64
```

## boards/chipyard/pynqz1_all_f40/board.yml
```yaml
board:
  name: chipyard_pynqz1_all_f40
  full_name: Chipyard dual-core Rocket + MBP P-ext + PDM mic + RGB LEDs + RoCC engine (Nch8) + SSD1306 I2C + 4 buttons + HM01B0 capture DMA, no TACIT, on PYNQ-Z1, FCLK0 40 MHz
  vendor: chipyard
  socs:
    - name: rocketchip_virt_riscv64
```

## boards/chipyard/pynqz1_cam/board.yml
```yaml
board:
  name: chipyard_pynqz1_cam
  full_name: Chipyard dual-core Rocket + TACIT + MBP P-ext + PDM mic + RGB LEDs + RoCC engine + HM01B0 camera on PYNQ-Z1
  vendor: chipyard
  socs:
    - name: rocketchip_virt_riscv64
```

## boards/chipyard/pynqz1_mic/board.yml
```yaml
board:
  name: chipyard_pynqz1_mic
  full_name: Chipyard dual-core Rocket + TACIT + MBP P-ext + PDM microphone on PYNQ-Z1
  vendor: chipyard
  socs:
    - name: rocketchip_virt_riscv64
```

## boards/chipyard/pynqz1_micrgb/board.yml
```yaml
board:
  name: chipyard_pynqz1_micrgb
  full_name: Chipyard dual-core Rocket + TACIT + MBP P-ext + PDM microphone + RGB LEDs on PYNQ-Z1
  vendor: chipyard
  socs:
    - name: rocketchip_virt_riscv64
```

## boards/chipyard/pynqz1_micrgb_f40/board.yml
```yaml
board:
  name: chipyard_pynqz1_micrgb_f40
  full_name: Chipyard dual-core Rocket + TACIT + MBP P-ext + PDM microphone + RGB LEDs on PYNQ-Z1, FCLK0 40 MHz
  vendor: chipyard
  socs:
    - name: rocketchip_virt_riscv64
```

## boards/chipyard/pynqz1_micrgb_f41667/board.yml
```yaml
board:
  name: chipyard_pynqz1_micrgb_f41667
  full_name: Chipyard dual-core Rocket + TACIT + MBP P-ext + PDM microphone + RGB LEDs on PYNQ-Z1, FCLK0 41.6667 MHz
  vendor: chipyard
  socs:
    - name: rocketchip_virt_riscv64
```

## boards/chipyard/pynqz1_oled_f40/board.yml
```yaml
board:
  name: chipyard_pynqz1_oled_f40
  full_name: Chipyard dual-core Rocket + TACIT + MBP P-ext + PDM mic + RGB LEDs + RoCC engine (Nch8) + SSD1306 I2C on PYNQ-Z1, FCLK0 40 MHz
  vendor: chipyard
  socs:
    - name: rocketchip_virt_riscv64
```

## boards/chipyard/pynqz1_panel_f40/board.yml
```yaml
board:
  name: chipyard_pynqz1_panel_f40
  full_name: Chipyard dual-core Rocket + TACIT + MBP P-ext + PDM mic + RGB LEDs + RoCC engine (Nch8) + SSD1306 I2C + 4 buttons on PYNQ-Z1, FCLK0 40 MHz
  vendor: chipyard
  socs:
    - name: rocketchip_virt_riscv64
```

## boards/chipyard/pynqz1_pext/board.yml
```yaml
board:
  name: chipyard_pynqz1_pext
  full_name: Chipyard dual-core big.LITTLE Rocket + TACIT + MBP P-ext on PYNQ-Z1
  vendor: chipyard
  socs:
    - name: rocketchip_virt_riscv64
```
