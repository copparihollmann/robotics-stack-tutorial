## CMakeLists.txt
```
# SPDX-License-Identifier: Apache-2.0
#
# The decoupled RoCC engine on the board (ROCC_DECOUPLED.md section 8), bitstream 0x5A5A0010.
#   scripts/with_board.sh ./scripts/51_rocket_roccmoon.sh
#
# Five halves: placement (hart 1 answers custom-1, hart 1 still TRAPS on MBP's custom-0,
# hart 0 traps on custom-1); bit-exactness on the silicon (the engine against ModelBlaster's
# reference kernel AND the curated MBP kernel hart 0 runs); Moonshine Tiny's linear shapes
# timed both ways; the engine's own fill port at 1..8 outstanding; and the curated kernel
# files a ModelBlaster model links, compiled into one translation unit after the same
# `kernel_<op>` -> `kernel_<op>_<id>` rename generate_kernels.py applies.
cmake_minimum_required(VERSION 3.20.0)
find_package(Zephyr REQUIRED HINTS $ENV{ZEPHYR_BASE})
project(roccmoon_bench)

get_filename_component(SW "${CMAKE_CURRENT_SOURCE_DIR}/../../fpga/pynq-z2/sw" ABSOLUTE)
get_filename_component(KERN "${CMAKE_CURRENT_SOURCE_DIR}/../../fpga/pynq-z2/modelblaster/kernels" ABSOLUTE)

# A stand-in for ModelBlaster's kernels.c: the two roccmoon kernel files, renamed.
set(RM_TU "${CMAKE_CURRENT_BINARY_DIR}/rm_kernels.c")
file(WRITE "${RM_TU}" "/* generated: the roccmoon curated kernels, renamed as generate_kernels.py does */\n")
foreach(op linear_s8 conv2d_s8)
  file(READ "${KERN}/roccmoon/roccmoon_${op}_roccmoon_engine.c" _src)
  string(REGEX REPLACE "kernel_${op}([^_a-zA-Z0-9])" "rm_kernel_${op}\\1" _src "${_src}")
  file(APPEND "${RM_TU}" "${_src}\n")
endforeach()
set_property(DIRECTORY APPEND PROPERTY CMAKE_CONFIGURE_DEPENDS
  "${KERN}/roccmoon/roccmoon_linear_s8_roccmoon_engine.c"
  "${KERN}/roccmoon/roccmoon_conv2d_s8_roccmoon_engine.c")

target_include_directories(app PRIVATE ${SW} ${SW}/roccmoon)
# mbxr.c arrives through mbxr_rt.h inside rm_kernels.c, exactly as it would in kernels.c
target_sources(app PRIVATE src/main.c src/rocc.S src/ref_linear.c "${RM_TU}"
                           ${KERN}/pext/pext_linear_s8_pext_row_dot8.c
                           ${KERN}/pext_nl/pext_nl_matmul_b_s8_pext_dot8_exact.c)
set_source_files_properties(${KERN}/pext/pext_linear_s8_pext_row_dot8.c PROPERTIES
  COMPILE_DEFINITIONS "kernel_linear_s8=pext_kernel_linear_s8;MB_PEXT_HW=1")
# section 6: the attention matmul, the file a ModelBlaster model links, renamed the same way
set_source_files_properties(${KERN}/pext_nl/pext_nl_matmul_b_s8_pext_dot8_exact.c PROPERTIES
  COMPILE_DEFINITIONS "kernel_matmul_b_s8=pext_kernel_matmul_b_s8;MB_PEXT_HW=1")
# ...and a SECOND copy of the same file with the hoisted nest compiled out, so section 6 can time
# both on one machine with one set of buffers and compare their outputs BYTE FOR BYTE.  A tolerance
# would hide exactly the kind of mistake a hoist makes, so the gate is identity (MATMUL_B_COST.md
# section 14, P5).  Its statics are file-static, so the two copies do not collide.
set(MMB_REF_TU "${CMAKE_CURRENT_BINARY_DIR}/mmb_ref.c")
file(WRITE "${MMB_REF_TU}"
  "/* generated: pext_nl_matmul_b_s8_pext_dot8_exact.c with the specialised nest compiled out */\n"
  "#define MBP_MMB_NO_SPECIALIZE 1\n"
  "#define kernel_matmul_b_s8 pext_ref_matmul_b_s8\n"
  "#include \"${KERN}/pext_nl/pext_nl_matmul_b_s8_pext_dot8_exact.c\"\n")
set_property(DIRECTORY APPEND PROPERTY CMAKE_CONFIGURE_DEPENDS
  "${KERN}/pext_nl/pext_nl_matmul_b_s8_pext_dot8_exact.c")
target_sources(app PRIVATE "${MMB_REF_TU}")
set_source_files_properties("${MMB_REF_TU}" PROPERTIES COMPILE_DEFINITIONS "MB_PEXT_HW=1")
set_source_files_properties(src/main.c "${RM_TU}" PROPERTIES COMPILE_DEFINITIONS "MB_PEXT_HW=1")
```

## prj.conf
```kconfig
CONFIG_PRINTK=y
CONFIG_MAIN_STACK_SIZE=16384
# Two harts: the engine is hart 1's, the MBP kernels hart 0's.
CONFIG_SMP=y
CONFIG_MP_MAX_NUM_CPUS=2
CONFIG_SCHED_CPU_MASK=y
CONFIG_TIMESLICING=n
CONFIG_TICKLESS_KERNEL=y
CONFIG_SPEED_OPTIMIZATIONS=y
CONFIG_FPU=n
CONFIG_CBPRINTF_FP_SUPPORT=n
# The negative tests take an illegal-instruction trap and survive it.
CONFIG_EXTRA_EXCEPTION_INFO=y
# Buffers live in fixed physical windows high in DRAM, not on a heap.
CONFIG_HEAP_MEM_POOL_SIZE=0
```

## src/ref_linear.c
```c
/* SPDX-License-Identifier: Apache-2.0
 * ModelBlaster's kernel_linear_s8 reference_impl, verbatim (pipeline/reference_kernels.py),
 * renamed.  The engine and the curated MBP kernel are both checked against THIS. */
#include <stdint.h>
void ref_kernel_linear_s8(const int8_t *input, const int8_t *weight,
                      const int32_t *bias, int8_t *output,
                      int M, int K, int N,
                      int input_offset, int filter_offset, int output_offset,
                      int output_multiplier, int output_shift,
                      int activation_min, int activation_max) {
    for (int m = 0; m < M; m++) {
        for (int n = 0; n < N; n++) {
            int32_t acc = bias ? bias[n] : 0;
            for (int k = 0; k < K; k++) {
                int32_t in_v = (int32_t)input[m * K + k] + input_offset;
                int32_t w_v  = (int32_t)weight[n * K + k] + filter_offset;
                acc += in_v * w_v;
            }
            /* Q0.31 rounding multiply. */
            int64_t prod = (int64_t)acc * (int64_t)output_multiplier;
            prod = (prod + (1LL << 30)) >> 31;
            int32_t scaled = (int32_t)prod;
            if (output_shift > 0) {
                scaled = (int32_t)(((int64_t)scaled + ((int64_t)1 << (output_shift - 1))) >> output_shift);
            } else if (output_shift < 0) {
                scaled = scaled << (-output_shift);
            }
            scaled += output_offset;
            if (scaled < activation_min) scaled = activation_min;
            if (scaled > activation_max) scaled = activation_max;
            output[m * N + n] = (int8_t)scaled;
        }
    }
}
```
