/* SPDX-License-Identifier: Apache-2.0
 *
 * THE BOOT STATUS BLOCK: what the PS knows and the guest cannot find out for itself.
 *
 * The network identity of one of these boards lives on the WRONG SIDE of the SoC.  The WiFi
 * dongle is a USB device on the PS, so `wlan0` and its address belong to Linux; the OLED is
 * on the PL's TLI2C at 0x1004_0000 and belongs to the Rocket guest.  Neither can see the
 * other's half, and the PS cannot reach the I2C controller to draw the screen itself: its
 * only windows into the PL are the 4 KiB M_AXI_GP0 control shim at 0x4000_0000 (CTRL /
 * STATUS / MAGIC) and the DDR window at 0x1000_0000.  Widening that decode is an RTL change,
 * and 0x5A5A0038 is at 89.37 % LUT in 13,223 of 13,300 slices -- there is no room.
 *
 * So the PS writes what it knows into DRAM before it releases reset, and the guest reads it.
 * That channel already exists: host/run_rocket.py mmaps SOC_MEM_PHYS = 0x1000_0000 and
 * writes the image through it, and "Rocket's 0x8000_0000 IS physical 0x1000_0000".
 *
 * WHERE, AND WHY HERE.  MB_BOOT_STATUS_ADDR is 0x8F00_0000: above every fixed allocation in
 * this tree (mbxr_rt's stages end at 0x8E00_0000 and sign_live's L2 eviction sweep reads
 * 4 MiB from there), and inside the PS's window, which is 28 bits wide -- {4'd1, addr[27:0]}
 * -- so the PS can only reach Rocket 0x8000_0000 .. 0x8FFF_FFFF.  This is the last 16 MiB of
 * that window.  It is also inside CONFIG_SRAM (base 0x8000_0000, size 256 MiB), exactly as
 * mbxr_rt's buffers are; the convention in this tree is that the top of the region is for
 * fixed buffers and the image plus heap grow from the bottom.
 *
 * ============================================================================================
 * STALENESS IS THE FAILURE TO FEAR, NOT ABSENCE
 * ============================================================================================
 * DRAM IS NOT CLEARED BETWEEN LOADS.  A guest built with this feature and loaded by a loader
 * that does not write the block will read WHATEVER THE PREVIOUS RUN LEFT THERE -- and print a
 * confidently wrong IP address on the glass, which is worse than printing nothing.  Two
 * defences, and both are needed:
 *
 *   * `magic` must equal MB_BOOT_STATUS_MAGIC and `crc32` must cover the rest of the struct.
 *     A half-written or torn block fails the CRC rather than being believed.
 *   * `nonce` is regenerated by the loader on EVERY load.  It exists so a human comparing the
 *     console line against the loader's own output can tell a fresh block from a survivor.
 *
 * And the loader ZEROES the magic when it is not writing a block, rather than leaving the
 * previous one in place.  `mb_boot_status_get()` returning NULL is the honest answer; a stale
 * address is not.
 *
 * ============================================================================================
 * THE SEAT'S INSTANCE ADDRESS, AND WHY IT LIVES IN reserved RATHER THAN IN A BIGGER STRUCT
 * ============================================================================================
 * An attendee's FIRST action is plugging the board in, and at that moment they are not on
 * this network at all: they reach their own EC2 seat over their own internet, and until now
 * nothing told them where it is -- the screen showed this board's address, which is the one
 * address they cannot use, and the per-seat printed cards are gone (one shared passphrase).
 * The board itself knows the answer: a board at 10.42.0.NN is seat NN, so its instance is
 * aws-NN.iiswc, answered by the tutorial router's dnsmasq and by nothing else.  host/
 * aws_whoami.sh owns that rule and is the only place it lives.  But the resolver is on the PS
 * and the only screen is the guest's, which is this channel's whole reason for existing --
 * so the address rides this block, like every other thing the guest cannot find out itself.
 *
 * IT IS THE BARE IPv4 AND NOTHING ELSE, because 20 bytes is what `reserved` had:
 *
 *     "198.51.100.197"           15 B with its NUL   -- FITS
 *     "https://198.51.100.197/"  24 B                -- does not
 *     a 25x25 QR bitmap          79 B at one bit per module, before any framing -- does not
 *
 * The `https://` and the trailing `/` are rendered BY THE GUEST, around the digits.  That is
 * not a concession to the byte count; it is what makes this change SAFE, and it is why
 * MB_BOOT_STATUS_VERSION IS DELIBERATELY NOT BUMPED.  aws_ipv4 and reserved together occupy
 * exactly the twenty bytes reserved[20] occupied, at the same offset, so the layout -- which
 * IS the ABI -- is byte for byte what version 1 has always been.  Every combination works:
 *
 *     patched loader + unpatched guest   the guest ignores those bytes, as it always did
 *     unpatched loader + patched guest   the bytes are zero, so aws_ipv4 is the empty string
 *                                        and the guest reports NO INSTANCE, which is true
 *
 * Bumping the version would buy nothing and cost everything.  mb_boot_status_get() compares
 * `version` for EQUALITY, so a bump on one side makes the whole block report NOTHING -- not
 * just the new field -- and loader and guest would then have to land on all 31 cards in
 * lockstep or the boards go blank.  Backward compatibility is worth more here than the few
 * characters of formatting the guest now does for itself.  A QR code cannot be had on these
 * terms: it needs the struct to GROW, and therefore the version bumped and that lockstep
 * rollout, which is why it is a separate change and not this one.
 *
 * AND THE STALENESS THIS BLOCK'S GUARDS CANNOT SEE.  magic and crc32 catch a block that is
 * torn, or left over from a previous load.  They cannot catch one that was written correctly
 * and has since become WRONG: a seat's instance can be terminated and relaunched, and its
 * public address changes with it, while this block -- and the glass -- keep the address that
 * was true at boot.  CRC-valid, magic-valid, nonce-fresh, and wrong.  Nothing on the guest
 * side can notice, because the guest has no network; and the PS cannot quietly correct it in
 * place either, because a PS write AFTER reset drops lands outside the L2 the Rocket reads
 * through -- which is exactly why run_rocket.py writes this block BEFORE the release.  So the
 * cure is a reload, and it is cheap: dnsmasq answers .iiswc with TTL 0, so re-resolving costs
 * one packet.  The DETECTOR belongs on the PS side, where the network is: host/board_id.sh
 * resolves the seat afresh and prints it beside everything else the screen shows, so
 * board_id.sh disagreeing with the glass IS the staleness alarm -- the same comparison that
 * file already exists to make.  The uptime line on the screen dates the address, which is the
 * cheap human version of the same check.
 *
 * Everything is fixed-width, little-endian and fixed-offset: the writer is Python and the
 * reader is C, so the struct layout IS the ABI.  Do not reorder; append only, and bump
 * MB_BOOT_STATUS_VERSION when you do.
 */

#ifndef MB_BOOT_STATUS_H_
#define MB_BOOT_STATUS_H_

#include <stdint.h>
#include <string.h>

#define MB_BOOT_STATUS_ADDR     0x8F000000UL
#define MB_BOOT_STATUS_MAGIC    0x42533031u   /* "BS01" */
#define MB_BOOT_STATUS_VERSION  1u

/* 160 bytes.  Sizes are generous on purpose: an SSID is up to 32 bytes and a hostname up to
 * 63, and a truncated field would be a silent lie of exactly the kind this header exists to
 * prevent.  Every string is NUL-terminated by the writer AND bounded by the reader. */
struct mb_boot_status {
	uint32_t magic;          /* MB_BOOT_STATUS_MAGIC, or 0 for "no block" */
	uint32_t version;        /* MB_BOOT_STATUS_VERSION */
	uint32_t nonce;          /* fresh on every load; echo it to prove freshness */
	uint32_t crc32;          /* over the struct with this field taken as 0 */
	uint32_t soc_magic;      /* what the loader read at GP0+0x08, e.g. 0x5A5A0038 */
	uint32_t link_up;        /* 1 = the interface is up and has an address */
	int32_t  signal_dbm;     /* 0 if unknown (a wired interface, or no link) */
	uint32_t fclk_hz;        /* the clock the loader actually set */
	char     hostname[40];
	char     ifname[16];
	char     ipv4[16];       /* "10.42.0.13" */
	char     ssid[36];
	/* The attendee's own EC2 seat: "198.51.100.197", or "" when the loader could not
	 * resolve it.  The guest wraps it in https:// ... / when it draws it; see the section
	 * above for why the wrapper is not stored and why this is NOT a version bump.  These
	 * two fields are the twenty bytes that used to read `char reserved[20]`. */
	char     aws_ipv4[16];
	char     reserved[4];
};

#define MB_BOOT_STATUS_SIZE 160
_Static_assert(sizeof(struct mb_boot_status) == MB_BOOT_STATUS_SIZE,
	       "boot status layout is the PS/guest ABI -- do not reorder, append only");

/* Bit-reflected CRC-32 (the zlib/PNG one), so Python's binascii.crc32 and this agree. */
static inline uint32_t mb_boot_status_crc32(const void *buf, uint32_t len)
{
	const uint8_t *p = (const uint8_t *)buf;
	uint32_t c = 0xFFFFFFFFu;

	for (uint32_t i = 0; i < len; i++) {
		c ^= p[i];
		for (int k = 0; k < 8; k++) {
			c = (c >> 1) ^ (0xEDB88320u & (uint32_t)(-(int32_t)(c & 1u)));
		}
	}
	return c ^ 0xFFFFFFFFu;
}

/* Returns a pointer to a VALIDATED block, or NULL.  Copies into the caller's storage so a
 * later DRAM write cannot change what was already reported, and so the strings can be
 * NUL-bounded without writing to the shared window. */
static inline const struct mb_boot_status *mb_boot_status_get(struct mb_boot_status *into)
{
	struct mb_boot_status t;
	uint32_t want;

	memcpy(&t, (const void *)MB_BOOT_STATUS_ADDR, sizeof(t));
	if (t.magic != MB_BOOT_STATUS_MAGIC || t.version != MB_BOOT_STATUS_VERSION) {
		return NULL;
	}
	want = t.crc32;
	t.crc32 = 0;
	if (mb_boot_status_crc32(&t, sizeof(t)) != want) {
		return NULL;
	}
	t.crc32 = want;
	/* Bound every string even though the writer terminates them: a CRC-valid block is
	 * still a block whose producer might be a future version with different habits. */
	t.hostname[sizeof(t.hostname) - 1] = '\0';
	t.ifname[sizeof(t.ifname) - 1]     = '\0';
	t.ipv4[sizeof(t.ipv4) - 1]         = '\0';
	t.ssid[sizeof(t.ssid) - 1]         = '\0';
	t.aws_ipv4[sizeof(t.aws_ipv4) - 1] = '\0';
	memcpy(into, &t, sizeof(t));
	return into;
}

#endif /* MB_BOOT_STATUS_H_ */
