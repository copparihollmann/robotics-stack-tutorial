// -----------------------------------------------------------------------------
// Decimate-by-DECIM FIR, one time-multiplexed multiply-accumulate.
//
// Why one MAC and not NTAPS of them: at 34.4828 MHz there are 34482759/15994 = 2156
// system clocks per output sample and the filter needs 289 of them.  In sample-rate
// terms this is an extraordinarily slow filter, so the serial structure -- 1 DSP48E1,
// 2 block RAMs and a counter -- is not a compromise, it is the right shape.
//
// The coefficients come from gen_fir.py and carry three things at once: the
// anti-alias lowpass for the decimate-by-DECIM, the inverse of the CIC's passband
// droop, and the scale factor that gives the whole PDM->PCM chain a DC gain of
// 32768.  Do not renormalise them here.
//
// The MAC is the canonical inferrable pattern (a registered product into a P
// accumulator) rather than an explicit DSP48E1.  The Vivado 2023.1 segfault in
// PEXT_FEASIBILITY.md is specific to SEVERAL inferred multipliers feeding an adder
// tree; one multiplier feeding an accumulator is the pattern inference is built
// around.  ooc_pdm.tcl reports the DSP count, so a silent fall back to LUT
// multipliers shows up as a number rather than as a surprise on the board.
//
// Pipeline, and the off-by-one it is easy to get wrong:
//     cycle c    : read  hist[rptr]/coef[k]   (enabled by `run`)
//     cycle c+1  : a_r, b_r hold that tap
//     cycle c+2  : p_r holds the product, and acc absorbs it
// so the accumulate enable is `run` delayed by TWO, which is vpipe[1] -- not
// vpipe[2].  Using vpipe[2] adds the last tap twice and drops the first.
// -----------------------------------------------------------------------------
module pdm_fir_mac #(
  parameter integer DW       = 20,     // CIC output width
  parameter integer CW       = 18,     // coefficient width (DSP48E1 B port is 18)
  parameter integer AW       = 48,     // accumulator width (DSP48E1 P)
  parameter integer NTAPS    = 289,
  parameter integer DECIM    = 7,
  parameter integer SHIFT    = 22,
  parameter integer HISTLOG2 = 9       // history depth 2^HISTLOG2, must exceed NTAPS
) (
  input  wire                 clk,
  input  wire                 rst,
  input  wire                 in_valid,
  input  wire signed [DW-1:0] in_data,
  output reg                  out_valid,
  output reg  signed [15:0]   out_data,
  output reg                  saturated   // sticky
);
  localparam integer HD  = 1 << HISTLOG2;
  localparam integer TW  = (NTAPS < 4) ? 2 : $clog2(NTAPS);
  localparam integer DCW = (DECIM < 4) ? 2 : $clog2(DECIM);

  (* ram_style = "block" *) reg signed [DW-1:0] hist [0:HD-1];
  (* rom_style = "block" *) reg signed [CW-1:0] coef [0:NTAPS-1];
  // Generated by rtl_study/pdm/gen_fir.py -- regenerate with
  //     python3 rtl_study/pdm/gen_fir.py
  // An `include of explicit assignments rather than $readmemh, so the coefficients
  // have no relative-path question in Vivado (whose cwd during a bitstream build is
  // fpga/pynq-z2, not src/), in the out-of-context study, or under Verilator.
  initial begin
`include "pdm_fir_coeffs.vh"
  end

  reg [HISTLOG2-1:0] wptr, rptr;
  reg [DCW-1:0]      dcnt;
  reg [TW-1:0]       k;
  reg                run;
  reg [2:0]          vpipe, lastpipe;

  reg signed [DW-1:0]    a_r;
  reg signed [CW-1:0]    b_r;
  reg signed [DW+CW-1:0] p_r;
  reg signed [AW-1:0]    acc;

  // Synchronous reads, no reset on the read registers: that is what lets these two
  // arrays become block RAMs instead of ~300 LUTs of distributed RAM.
  always @(posedge clk) begin
    a_r <= hist[rptr];
    b_r <= coef[k];
    p_r <= a_r * b_r;
  end

  localparam signed [AW-1:0] RND = (SHIFT == 0) ? {AW{1'b0}}
                                                : ({{(AW-1){1'b0}}, 1'b1} <<< (SHIFT-1));
  wire signed [AW-1:0] scaled = (acc + RND) >>> SHIFT;
  wire over  = (scaled > 48'sd32767);
  wire under = (scaled < -48'sd32768);
  wire signed [15:0] clipped = over  ?  16'sd32767 :
                               under ? -16'sd32768 : scaled[15:0];

  always @(posedge clk) begin
    if (rst) begin
      wptr <= 0; rptr <= 0; dcnt <= 0; k <= 0; run <= 1'b0;
      vpipe <= 3'b0; lastpipe <= 3'b0; acc <= 0;
      out_valid <= 1'b0; out_data <= 16'sd0; saturated <= 1'b0;
    end else begin
      out_valid <= 1'b0;

      if (in_valid) begin
        hist[wptr] <= in_data;
        wptr <= wptr + 1'b1;
        if (dcnt == DECIM[DCW-1:0] - 1'b1) begin
          dcnt <= 0;
          run  <= 1'b1;
          k    <= 0;
          rptr <= wptr;         // hist[wptr] is written this cycle; the read at the
        end else begin          // next cycle returns the new value.
          dcnt <= dcnt + 1'b1;
        end
      end

      vpipe    <= {vpipe[1:0],    run};
      lastpipe <= {lastpipe[1:0], run && (k == NTAPS[TW-1:0] - 1'b1)};

      if (run) begin
        if (k == NTAPS[TW-1:0] - 1'b1) run <= 1'b0;
        else begin k <= k + 1'b1; rptr <= rptr - 1'b1; end
      end

      if      (vpipe[1] && !vpipe[2]) acc <= p_r;            // first tap of a pass
      else if (vpipe[1])              acc <= acc + p_r;

      if (lastpipe[2]) begin
        out_data  <= clipped;
        out_valid <= 1'b1;
        if (over || under) saturated <= 1'b1;
      end
    end
  end
endmodule
