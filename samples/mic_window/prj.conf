## CMakeLists.txt
```
# SPDX-License-Identifier: Apache-2.0
#
# Lab B119 -- assemble the encoder's 64,000-sample int8 input window from the microphone.
#   ./scripts/77_rocket_mic_window.sh --build-only
#   scripts/with_board.sh ./scripts/77_rocket_mic_window.sh --prebuilt out/rocket_mic_window_prebuilt
cmake_minimum_required(VERSION 3.20.0)
find_package(Zephyr REQUIRED HINTS $ENV{ZEPHYR_BASE})
project(mic_window)
target_sources(app PRIVATE src/main.c)
target_include_directories(app PRIVATE src)
```

## prj.conf
```kconfig
CONFIG_PRINTK=y
CONFIG_MAIN_STACK_SIZE=8192
CONFIG_SPEED_OPTIMIZATIONS=y
CONFIG_FPU=n
CONFIG_CBPRINTF_FP_SUPPORT=n
CONFIG_EXTRA_EXCEPTION_INFO=y
# RAW MMIO, NOT THE DMIC DRIVER.  dmic_pdm_mmio.c negotiates the rate from the RATE
# register with a 10-permille tolerance.  This microphone is 160 permille off that
# register (Lab B110), so the driver would REFUSE it -- correctly, since the register is
# a compile-time constant for a 34.4828 MHz build and this bitstream runs at 40 MHz.
# The devicetree node IS status="okay" for this board; it is simply not used here.
CONFIG_AUDIO=n
CONFIG_AUDIO_DMIC=n
# One hart.  PUSH-TO-TALK: hart 0 polls the FIFO and resamples in the 2156 core cycles
# between samples, so there is nothing for hart 1 to drain.  See main.c's header for why
# continuous capture is an RTF question and not a drain question on this image.
CONFIG_HEAP_MEM_POOL_SIZE=0
```

## src/main.c
```c
/*
 * Copyright (c) 2026 IISWC tutorial
 * SPDX-License-Identifier: Apache-2.0
 *
 * Lab B119 -- ASSEMBLE THE ENCODER'S 64,000-SAMPLE int8 INPUT WINDOW FROM THE MICROPHONE.
 *
 * This lab does NOT run the model.  The combined image has an open correctness defect
 * (max_abs_err 65, Lab B117 is chasing it) and feeding it microphone audio would confound
 * two unknowns.  What this produces is the WINDOW, and the evidence that it is well formed.
 *
 * ----------------------------------------------------------------------------------------
 * PUSH-TO-TALK, AND WHY IT IS NOT A COMPROMISE
 *
 * The FIFO is 1024 samples = 55.2 ms at 18,552.876 Hz and one inference takes 3.34 s, so
 * continuous capture would need hart 1 draining into DRAM while hart 0 runs the model.
 * IT IS NOT BUILT, AND THE REASON IS ARITHMETIC RATHER THAN EFFORT:
 *
 *     RTF_e2e on this image is 1.403303 (Lab B116, out/b116_lnsplit).  RTF > 1 means the
 *     model consumes 4.0 s of audio every 5.61 s of wall clock.  A perfectly drained FIFO
 *     does not change that; the backlog grows without bound at 1.61 s per utterance.
 *     CONTINUOUS CAPTURE IS NOT A DRAIN PROBLEM ON THIS IMAGE, IT IS AN RTF PROBLEM, and
 *     it becomes possible exactly when RTF crosses 1 -- which is the session's own target.
 *
 * So: hart 0 captures for 4.0022 s, filling the window, and only then would inference run.
 * One MMIO load per sample is 2156 core cycles apart and the resampler needs ~552 of them
 * (below), so the capturing hart is never the bottleneck and hart 1 is not needed.  The
 * cost of the choice is a gap between utterances, not a glitch inside one.
 *
 * ----------------------------------------------------------------------------------------
 * THE THREE CONTROLS, EACH OF WHICH CAN FAIL
 *
 *  1. THE RATE, by the clock and not by the register.  64,000 OUTPUT samples require
 *     74,212 input samples, which at 18,552.876 Hz is 4.0002 s.  If the resampler were a
 *     pass-through the same 64,000 outputs would take 3.4496 s.  Measured against mtime,
 *     those two are 16 % apart and cannot be confused.
 *
 *  2. THE ARITHMETIC, on a signal the board generates itself.  A 1000.000 Hz sine is
 *     synthesised AT f_mic, pushed through the SAME resampler, and Goertzel'd at 1000 Hz
 *     and at 862.400 Hz (= 1000 * 16000/18552.876, where a pass-through would put it).
 *     This needs no acoustic source and it is the direct analogue of Lab B110's
 *     `dc_bypass` arm: the discriminating control runs in the same pass as the claim.
 *
 *  3. THE TWO EVALUATION ORDERS.  MP2_AB runs the window again through the BANK order
 *     (539 phases materialised at boot from the same 640 bytes of coefficients) and the
 *     two must be BYTE-IDENTICAL.  They are also timed, which is the measurement that
 *     answers "is a 539-phase table affordable against a 16 KB L1D" instead of arguing it.
 *
 * ----------------------------------------------------------------------------------------
 * THE DEFECT THIS CODE IS SHAPED AROUND
 *
 * Lab B110 found that CTRL[3] `clear_sticky` does NOT clear STATUS[3] `overrun` -- only
 * `fifo_reset` does -- contradicting pdm_mic_core.v's own header and MICROPHONE.md s3.6.
 * The RTL says why: STATUS[4] `saturated` is a sticky register cleared by `clear_pulse`,
 * but STATUS[3] is `fifo_overrun`, a reg INSIDE pdm_mic_fifo.v cleared only by its `rst`.
 * So this lab (a) re-runs that as a control, and (b) uses fifo_reset, never clear_sticky,
 * to arm the overrun watch.  An overrun REFUSES the window; it does not transcribe a
 * discontinuity.
 */

#include <zephyr/kernel.h>
#include <zephyr/sys/sys_io.h>
#include <stdint.h>

#include "b119_resamp.h"

#define MIC_BASE   0x10090000UL
#define R_ID       (MIC_BASE + 0x00)
#define R_CTRL     (MIC_BASE + 0x08)
#define R_STATUS   (MIC_BASE + 0x10)
#define R_LEVEL    (MIC_BASE + 0x18)
#define R_DATA     (MIC_BASE + 0x20)
#define R_RATE     (MIC_BASE + 0x28)
#define R_DEPTH    (MIC_BASE + 0x30)

#define ID_MAGIC          0x504D4331U
#define CTRL_ENABLE       0x1U
#define CTRL_FIFO_RESET   0x2U
#define CTRL_DC_BYPASS    0x4U
#define CTRL_CLR_STICKY   0x8U
#define ST_SETTLING       0x1U
#define ST_EMPTY          0x2U
#define ST_FULL           0x4U
#define ST_OVERRUN        0x8U
#define ST_SATURATED      0x10U

#define NOUT   64000                 /* the encoder's IW */

int32_t b119_rs_bank[B119_RS_UP][B119_RS_N];   /* built at boot; see b119_resamp.h */

#define NOUT     64000               /* the encoder's IW */
/* PREROLL -- WHAT IS DISCARDED, AND WHY IT IS 1024 AND NOT 40.
 *
 * The resampler's own 40-tap history fills in 40 input samples (34 outputs).  That is NOT
 * what dominates.  Lab B119's first board arm captured a window whose first 500 output
 * samples carried a decaying transient 12 dB above the steady state, and the arithmetic
 * names it exactly: the DC blocker is y[n] = x[n] - x[n-1] + (1 - 2^-7)*y[n-1], a pole
 * with a 128-sample time constant, and it starts from ZERO facing the 1074 counts of DC
 * that the microphone's 0.5164 PDM density produces (MICROPHONE.md s3.5).  Decaying 1074
 * counts to below 1 takes 128*ln(1074) = 894 input samples = 48.2 ms.
 *
 * ***STATUS[0] `settling` CLEARING IS NOT THE MOMENT THE OUTPUT IS USABLE.***  The SETTLE
 * counter (131,072 PDM bits = 45.875 ms) holds the CIC and FIR in reset; the DC blocker
 * only BEGINS converging when samples start to flow.  1024 outputs is 64.0 ms, past the
 * 48.2 ms the pole needs, and the discarded pre-roll is MEASURED and printed rather than
 * silently dropped.
 */
#define PREROLL   1024
#define SYN_N    16384               /* the synthetic control's output length */
#define RANGE_N   8000               /* the auto-range pre-roll: 0.5 s of outputs */
/* The encoder's own int8 grid, in the units the calibration is stated in: the pinned
 * corpus's int8 rms, x1000.  b119_resamp.py --quantcheck computes it (21.773 counts over
 * 7,696,558 samples).  NOTHING else about the grid is needed on the board. */
#define TARGET_I8_RMS_MILLI  21773

static int8_t  win[NOUT];
static int8_t  syn_a[SYN_N], syn_b[SYN_N];
static int16_t raw_head[1024];
static uint32_t hist256[256];

static uint32_t gain_m = B119_RS_GAIN_M_DEFAULT;
static int32_t  gain_s = B119_RS_GAIN_S_DEFAULT;

static void ctrl(uint32_t v) { sys_write32(v, R_CTRL); }

static uint32_t fnv1a(const int8_t *p, uint32_t n)
{
	uint32_t h = 2166136261u;

	for (uint32_t i = 0; i < n; i++) { h ^= (uint32_t)(uint8_t)p[i]; h *= 16777619u; }
	return h;
}

/* cos(2*pi*t) for t in Q15 of one turn, result Q15.  65-entry table + linear
 * interpolation: 0.03 % worst case, which is a control's accuracy and not a signal's.
 * No libm and no float -- the guest is CONFIG_FPU=n. */
static const int16_t COSQ[65] = {
	32767, 32610, 32138, 31357, 30273, 28899, 27246, 25330, 23170, 20787, 18205, 15447,
	12540, 9512, 6393, 3212, 0, -3212, -6393, -9512, -12540, -15447, -18205, -20787,
	-23170, -25330, -27246, -28899, -30273, -31357, -32138, -32610, -32767, -32610,
	-32138, -31357, -30273, -28899, -27246, -25330, -23170, -20787, -18205, -15447,
	-12540, -9512, -6393, -3212, 0, 3212, 6393, 9512, 12540, 15447, 18205, 20787,
	23170, 25330, 27246, 28899, 30273, 31357, 32138, 32610, 32767
};

static int32_t cos_q15(int64_t t_q15)
{
	int64_t t = t_q15 & 32767;
	int64_t idx = (t * 64) / 32768;
	int64_t frac = (t * 64) - idx * 32768;

	return (int32_t)(COSQ[idx] + ((COSQ[idx + 1] - COSQ[idx]) * frac) / 32768);
}

/* Goertzel magnitude^2 at f (millihertz) over n int8 samples at fs Hz.  Scaled down to
 * keep the console free of 64-bit formats: returns log2-ish magnitude as an integer. */
static uint32_t goertzel_db(const int8_t *x, uint32_t n, uint32_t f_milli, uint32_t fs)
{
	int64_t c = cos_q15(((int64_t)f_milli * 32768) / ((int64_t)fs * 1000));
	int64_t coeff = 2 * c, s0, s1 = 0, s2 = 0;
	uint64_t mag;
	uint32_t e = 0;

	for (uint32_t i = 0; i < n; i++) {
		s0 = (int64_t)x[i] + ((coeff * s1) >> 15) - s2;
		s2 = s1; s1 = s0;
		if (s1 > (1LL << 40) || s1 < -(1LL << 40)) { s1 >>= 8; s2 >>= 8; e += 8; }
	}
	{
		int64_t m = s1 * s1 + s2 * s2 - ((coeff * s1 * s2) >> 15);

		mag = (m < 0) ? 0 : (uint64_t)m;
	}
	/* return 100*log2(mag) + 200*e, so ratios are differences and nothing is 64-bit */
	{
		uint32_t lg = 0;
		uint64_t v = mag;

		while (v > 1) { v >>= 1; lg++; }
		return lg * 100u + 200u * e;
	}
}

static uint64_t isqrt64(uint64_t v)
{
	uint64_t r = 0, b = 1ULL << 40;

	while (b > v) { b >>= 2; }
	while (b) {
		if (v >= r + b) { v -= r + b; r = (r >> 1) + b; } else { r >>= 1; }
		b >>= 2;
	}
	return r;
}

/* ---- the capture ----------------------------------------------------------------------
 * PUSH-TO-TALK: hart 0 polls LEVEL, pops one sample, and resamples it in the 2156 core
 * cycles before the next one arrives.  Nothing runs on hart 1 and nothing is buffered
 * beyond the 40-sample filter history: the int8 window IS the buffer.
 */
struct cap_result {
	uint32_t nin, nout, ticks;
	uint32_t st_first, st_or;
	int refused;
	uint32_t pre_rms, pre_peak;   /* the DISCARDED pre-roll, measured */
	struct b119_rs rs;
};

static uint64_t isqrt64(uint64_t v);

static void capture(struct cap_result *r, int8_t *dst, uint32_t want, uint32_t preroll)
{
	struct b119_rs *s = &r->rs;
	int8_t o[4];
	uint32_t got = 0, dropped = 0, nin = 0, st_or = 0;

	b119_rs_init(s, (int32_t)gain_m, gain_s);
	r->refused = 0;
	/* fifo_reset, NOT clear_sticky.  B110's defect: clear_sticky does not clear
	 * STATUS[3] overrun; only the FIFO's own reset does.  The reset arms the watch. */
	ctrl(CTRL_ENABLE | CTRL_FIFO_RESET | CTRL_CLR_STICKY);
	ctrl(CTRL_ENABLE);
	while ((sys_read32(R_STATUS) & ST_SETTLING) != 0U) { }
	ctrl(CTRL_ENABLE | CTRL_FIFO_RESET);
	ctrl(CTRL_ENABLE);
	while (sys_read32(R_LEVEL) != 0U) { (void)sys_read32(R_DATA); }
	while (sys_read32(R_LEVEL) == 0U) { }
	r->st_first = sys_read32(R_STATUS);
	r->ticks = k_cycle_get_32();

	while (got < want) {
		uint32_t guard = 0;

		while (sys_read32(R_LEVEL) == 0U) {
			if (++guard > 400000000U) { r->refused |= 2; goto done; }
		}
		st_or |= sys_read32(R_STATUS);
		{
			int16_t v = (int16_t)sys_read32(R_DATA);
			int g;

			if (nin < 1024) { raw_head[nin] = v; }
			nin++;
			g = b119_rs_push(s, v, o, 4);
			for (int j = 0; j < g; j++) {
				if (dropped < preroll) {
					dropped++;
					if (dropped == preroll) {
						/* measure what is being thrown away, then start
						 * the statistics the calibration reads. */
						r->pre_rms = (uint32_t)isqrt64((uint64_t)
							(s->sum_sq / (int64_t)(s->nout ? s->nout : 1)));
						r->pre_peak = (uint32_t)s->peak_abs;
						b119_rs_stats_reset(s);
					}
					continue;
				}
				if (got < want) { dst[got++] = o[j]; }
			}
		}
	}
done:
	r->ticks = k_cycle_get_32() - r->ticks;
	r->nin = nin; r->nout = got;
	r->st_or = st_or | sys_read32(R_STATUS);
	/* AN OVERRUN REFUSES THE WINDOW.  A 55 ms hole in the middle of an utterance is a
	 * discontinuity, and transcribing one is worse than not transcribing it. */
	if (r->st_or & ST_OVERRUN) { r->refused |= 1; }
	ctrl(0U);
}

/* ---- control 1: the board's own 1000.000 Hz sine, through the same resampler ----------
 * If the resampler were a pass-through the tone would come out at
 *   1000 * 16000 / 18552.876 = 862.400 Hz.
 * Both bins are measured in the same pass, which is the shape of B110's dc_bypass arm.
 * And the DIRECT and BANK evaluation orders both run, on the same samples, and must
 * produce IDENTICAL bytes.
 */
static void synth_control(void)
{
	struct b119_rs s;
	int8_t o[4];
	uint32_t got, i, t0, t1, tdir, tbank, nd;
	int mode;

	for (mode = 0; mode < 2; mode++) {
		int8_t *dst = mode ? syn_b : syn_a;

		b119_rs_init(&s, (int32_t)gain_m, gain_s);
		s.use_bank = mode;
		got = 0;
		t0 = k_cycle_get_32();
		for (i = 0; got < SYN_N && i < 4u * SYN_N; i++) {
			int64_t t = ((int64_t)i * 1000 * 32768 * 1000) / B119_RS_FMIC_MILLIHZ;
			int16_t xv = (int16_t)((12000 * (int64_t)cos_q15(t - 8192)) >> 15);
			int g = b119_rs_push(&s, xv, o, 4);

			for (int j = 0; j < g && got < SYN_N; j++) { dst[got++] = o[j]; }
		}
		t1 = k_cycle_get_32();
		if (mode) { tbank = t1 - t0; } else { tdir = t1 - t0; }
	}
	nd = 0;
	for (i = 0; i < SYN_N; i++) { if (syn_a[i] != syn_b[i]) { nd++; } }
	printk("MW_SYNTH n=%u g1000_clog2=%u g862_clog2=%u g4000_clog2=%u verdict=%s\n",
	       SYN_N,
	       goertzel_db(syn_a + 512, 15360, 1000000u, 16000u),
	       goertzel_db(syn_a + 512, 15360,  862400u, 16000u),
	       goertzel_db(syn_a + 512, 15360, 4000000u, 16000u),
	       (goertzel_db(syn_a + 512, 15360, 1000000u, 16000u) >
	        goertzel_db(syn_a + 512, 15360, 862400u, 16000u) + 400u)
	       ? "RESAMPLED" : "PASSTHROUGH_OR_BROKEN");
	printk("MW_AB direct_ticks=%u bank_ticks=%u bytes_differing=%u of %u fnv_direct=0x%08x "
	       "fnv_bank=0x%08x verdict=%s\n", tdir, tbank, nd, SYN_N,
	       fnv1a(syn_a, SYN_N), fnv1a(syn_b, SYN_N),
	       nd == 0 ? "IDENTICAL" : "DISAGREE");
}

/* ---- control 2: B110's overrun defect, re-run ------------------------------------------ */
static void overrun_control(void)
{
	uint32_t a, b, c;

	ctrl(CTRL_ENABLE | CTRL_FIFO_RESET | CTRL_CLR_STICKY);
	ctrl(CTRL_ENABLE);
	while ((sys_read32(R_STATUS) & ST_SETTLING) != 0U) { }
	k_msleep(200);                      /* 1024 samples is 55 ms; 200 ms MUST overrun */
	a = sys_read32(R_STATUS);
	ctrl(CTRL_ENABLE | CTRL_CLR_STICKY);
	ctrl(CTRL_ENABLE);
	b = sys_read32(R_STATUS);
	ctrl(CTRL_ENABLE | CTRL_FIFO_RESET);
	ctrl(CTRL_ENABLE);
	c = sys_read32(R_STATUS);
	printk("MW_OVR provoked=0x%02x after_clear_sticky=0x%02x after_fifo_reset=0x%02x "
	       "verdict=%s\n", a, b, c,
	       ((a & ST_OVERRUN) && (b & ST_OVERRUN) && !(c & ST_OVERRUN))
	       ? "B110_DEFECT_CONFIRMED" : "UNEXPECTED");
	ctrl(0U);
}

static void dump_window(const int8_t *x, uint32_t n)
{
	static const char hx[] = "0123456789abcdef";
	char line[129];

	printk("MW_DUMP_BEGIN n=%u bytes_per_line=64\n", n);
	for (uint32_t i = 0; i < n; i += 64) {
		uint32_t k = 0;

		for (uint32_t j = 0; j < 64 && i + j < n; j++) {
			uint8_t v = (uint8_t)x[i + j];

			line[k++] = hx[v >> 4]; line[k++] = hx[v & 15];
		}
		line[k] = 0;
		printk("MWD %05u %s\n", i, line);
	}
	printk("MW_DUMP_END\n");
}

int main(void)
{
	struct cap_result r, pre;
	uint32_t hz = sys_clock_hw_cycles_per_sec();
	int32_t mn = 127, mx = -128;
	int64_t sum = 0, sumabs = 0, sumsq = 0;
	uint32_t zeros = 0, distinct = 0;

	printk("\nMW_BEGIN base=0x%08lx build=" __DATE__ " " __TIME__ "\n", (unsigned long)MIC_BASE);
	printk("MW_GUEST mtime_hz=%u\n", hz);
	printk("MW_CFG taps=%d D=%d q=%d hq=%d up=%d down=%d fmic_millihz=%d gain_m=%u "
	       "gain_s=%d scale_x_e9=%d nout=%d preroll=%d\n",
	       B119_RS_N, B119_RS_D, B119_RS_Q, B119_RS_HQ, B119_RS_UP, B119_RS_DOWN,
	       B119_RS_FMIC_MILLIHZ, gain_m, gain_s, B119_RS_SCALE_X_E9, NOUT, PREROLL);

	{
		uint32_t id = sys_read32(R_ID), depth = sys_read32(R_DEPTH);

		printk("MW_REGS id=0x%08x depth=%u rate_reg_millihz=%u\n",
		       id, depth, sys_read32(R_RATE));
		if (id != ID_MAGIC || depth != 1024U) {
			printk("MW_VERDICT NOT_MAPPED\nMW_DONE\n");
			return 0;
		}
		printk("MW_GATE1 PASS id and depth are both exact\n");
	}

	{
		uint32_t t0 = k_cycle_get_32();

		b119_rs_build_bank();
		printk("MW_BANK bytes=%u build_ticks=%u\n",
		       (unsigned)sizeof(b119_rs_bank), k_cycle_get_32() - t0);
	}
	synth_control();
	overrun_control();

	/* AUTO-RANGE.  One gain constant is the deliverable; this is the instrument that
	 * reads it.  The pre-roll measures the RESAMPLED signal's rms in int16 mic counts --
	 * the physical quantity -- and the gain follows from it by integer division.  Both
	 * the raw level and the gain are printed, because an auto-ranged window always LOOKS
	 * on scale: it is the mic-count rms that says whether it was speech or room noise. */
	capture(&pre, win, RANGE_N, PREROLL);
	{
		uint32_t rms = (uint32_t)isqrt64((uint64_t)(pre.rs.sum_sq
				/ (int64_t)(pre.rs.nout ? pre.rs.nout : 1)));

		printk("MW_RANGE nout=%u rms_counts=%u peak_counts=%u preroll_rms=%u "
		       "preroll_peak=%u status_or=0x%02x saturated=%d refused=%d\n",
		       pre.rs.nout, rms, (uint32_t)pre.rs.peak_abs, pre.pre_rms, pre.pre_peak,
		       pre.st_or, (pre.st_or & ST_SATURATED) ? 1 : 0, pre.refused);
		b119_rs_gain_from_rms(rms, TARGET_I8_RMS_MILLI, (int32_t *)&gain_m, &gain_s);
		printk("MW_GAIN target_i8_rms_milli=%d measured_rms_counts=%u gain_m=%u "
		       "gain_s=%d\n", TARGET_I8_RMS_MILLI, rms, gain_m, gain_s);
	}

	printk("MW_CAP_BEGIN want=%d preroll=%d expect_inputs=%u expect_us=%u\n",
	       NOUT, PREROLL, b119_rs_inputs_for(NOUT + PREROLL),
	       (uint32_t)(((uint64_t)b119_rs_inputs_for(NOUT + PREROLL) * 1000000ULL * 1000ULL)
	                  / B119_RS_FMIC_MILLIHZ));
	capture(&r, win, NOUT, PREROLL);
	{
		uint32_t us = (uint32_t)(((uint64_t)r.ticks * 1000000ULL) / hz);

		printk("MW_CAP nin=%u nout=%u ticks=%u us=%u status_first=0x%02x status_or=0x%02x "
		       "refused=%d clipped=%u sat_hi=%u sat_lo=%u peak_abs=%u\n",
		       r.nin, r.nout, r.ticks, us, r.st_first, r.st_or, r.refused,
		       r.rs.nclip, r.rs.nsat_hi, r.rs.nsat_lo, (uint32_t)r.rs.peak_abs);
		/* THE RATE, FROM THE CLOCK.  64,000 outputs take 4.0002 s through the
		 * resampler and 3.4496 s through a pass-through: 16 % apart. */
		printk("MW_RATE nin=%u elapsed_us=%u in_rate_millihz=%u out_rate_millihz=%u "
		       "passthrough_us=%u\n", r.nin, us,
		       (uint32_t)(((uint64_t)r.nin * hz * 1000ULL) / (r.ticks ? r.ticks : 1)),
		       (uint32_t)(((uint64_t)r.nout * hz * 1000ULL) / (r.ticks ? r.ticks : 1)),
		       (uint32_t)((uint64_t)NOUT * 1000000000ULL / B119_RS_FMIC_MILLIHZ * 1000ULL
		                  / 1000ULL));
		printk("MW_TRANSIENT preroll_outputs=%d preroll_rms=%u preroll_peak=%u  "
		       "(the DC blocker converging; discarded, and measured so it is not "
		       "silently dropped)\n", PREROLL, r.pre_rms, r.pre_peak);
		printk("MW_LEVEL resampled_rms_counts=%u peak_counts=%u  (int16 mic counts, "
		       "BEFORE the gain, over the KEPT samples only -- the calibration row)\n",
		       (uint32_t)isqrt64((uint64_t)(r.rs.sum_sq / (int64_t)(r.rs.nout ? r.rs.nout : 1))),
		       (uint32_t)r.rs.peak_abs);
	}
	printk("MW_RAWHEAD");
	for (int i = 0; i < 32; i++) { printk(" %d", raw_head[i]); }
	printk("\n");

	for (int i = 0; i < 256; i++) { hist256[i] = 0; }
	for (uint32_t i = 0; i < NOUT; i++) {
		int32_t v = win[i];

		if (v < mn) { mn = v; }
		if (v > mx) { mx = v; }
		sum += v; sumabs += (v < 0) ? -v : v; sumsq += (int64_t)v * v;
		if (v == 0) { zeros++; }
		hist256[(uint8_t)v]++;
	}
	for (int i = 0; i < 256; i++) { if (hist256[i]) { distinct++; } }
	printk("MW_WSTAT n=%d min=%d max=%d mean_milli=%d meanabs_milli=%d rms_milli=%u "
	       "zeros=%u distinct=%u\n", NOUT, mn, mx,
	       (int)((sum * 1000) / NOUT), (int)((sumabs * 1000) / NOUT),
	       (uint32_t)isqrt64((uint64_t)((sumsq * 1000000) / NOUT)),
	       zeros, distinct);
	printk("MW_BAND");
	for (uint32_t f = 250; f <= 7000; f = (f * 2)) {
		printk(" %u:%u", f, goertzel_db(win, 16384, f * 1000u, 16000u));
	}
	printk("\n");
	printk("MW_FNV window=0x%08x\n", fnv1a(win, NOUT));
	for (int b = 0; b < 16; b++) {
		printk("MW_FNVB blk=%d off=%d fnv=0x%08x\n", b, b * 4000, fnv1a(win + b * 4000, 4000));
	}
	printk("MW_HIST");
	for (int i = 0; i < 256; i++) { printk(" %u", hist256[i]); }
	printk("\n");

	if (r.refused) {
		printk("MW_VERDICT REFUSED status_or=0x%02x refused=%d -- the window is NOT offered\n",
		       r.st_or, r.refused);
	} else {
		printk("MW_VERDICT WINDOW_OK n=%d\n", NOUT);
		dump_window(win, NOUT);
	}
	printk("MW_DONE\n");
	return 0;
}
```

## src/b119_resamp.h
```c
/*
 * Copyright (c) 2026 IISWC tutorial
 * SPDX-License-Identifier: Apache-2.0
 *
 * Lab B119 -- THE PATH FROM THE MICROPHONE TO THE ENCODER'S INPUT TENSOR.
 *
 * ONE SOURCE, COMPILED TWICE.  This header is the whole arithmetic of the audio front
 * end, and Zephyr on the board and the host verifier in
 * fpga/pynq-z2/modelblaster/moonshine/b119_resamp.py --verify-c compile THE SAME FILE.
 * Nothing here is float: the guest is built CONFIG_FPU=n and every double on this hart is
 * soft-float (Lab B115 measured one such routine at 353,000 cycles per call).
 *
 * ------------------------------------------------------------------------------------
 * WHY A RESAMPLER AT ALL
 *
 * The PDM microphone's RATE register (0x28) reports 15,993,859 millihertz.  It is a
 * COMPILE-TIME Verilog constant computed for FCLK0 = 34.4828 MHz.  0x5A5A0035 runs at
 * 40.000000 MHz and the real rate is set by the divisor chain and nothing else:
 *
 *     f_mic = FCLK0 / (2*PDM_HALF * CIC_R * FIR_DECIM) = 40e6 / (14 * 22 * 7)
 *           = 40e6 / 2156 = 18,552.8757 Hz
 *
 * Lab B110 measured 18,552.875 Hz over 64,000 samples, -0.00004 % off that.  The
 * encoder's first dispatch is hard-shaped IW = 64000 samples at 16 kHz, so feeding raw
 * microphone samples would present speech 15.955 % fast.  The ratio is EXACT and rational:
 *
 *     f_out / f_mic = 16000 * 2156 / 40e6 = 34,496,000 / 40,000,000 = 539 / 625
 *
 * gcd(539, 625) = 1 (539 = 7*7*11, 625 = 5^4), so output k reads the input at
 * t_k = k * 625/539 input samples: index n_k = floor(k*625/539), fraction mu_k = m_k/539
 * with m_k = (k*625) mod 539.  Only 539 distinct fractions exist and the pattern repeats
 * every 539 outputs / 625 inputs.  Nothing here ever divides.
 *
 * ------------------------------------------------------------------------------------
 * WHY THE ANTI-ALIAS FILTER IS THIS LONG, MEASURED AND NOT ASSUMED
 *
 * The output Nyquist is 8000 Hz and the input Nyquist is 9276.4 Hz, so input content in
 * 8000..9276.4 Hz folds onto 6723.6..8000 Hz.  It would be comfortable to assume the
 * microphone's own 289-tap FIR has already removed it.  IT HAS NOT.  That FIR's stopband
 * edge is 8993 Hz AT ITS DESIGN RATE, which at 40 MHz scales to 10,431.8 Hz, and its
 * passband edge scales to 8119.3 Hz.  Evaluated from the shipping coefficients
 * (fpga/pynq-z2/src/pdm_fir_coeffs.vh, 289 taps, sum 586717) against the CIC^4/22 at
 * FCLK0 = 40 MHz, the chain's own response over the folding band is:
 *
 *     8000 Hz  -0.00 dB     8500 Hz  -0.37 dB     9000 Hz  -3.53 dB
 *     8119 Hz  -0.00 dB     8801 Hz  -1.70 dB     9276 Hz  -7.79 dB
 *
 * power-averaged over 8000..9276 Hz: -1.39 dB.  The folding band arrives essentially
 * UNATTENUATED and the entire anti-alias burden is on this filter.
 *
 * ------------------------------------------------------------------------------------
 * THE STRUCTURE, AND THE TWO PATHS THAT MUST AGREE BIT FOR BIT
 *
 * A Farrow (polynomial-interpolator) structure: each tap's weight is a cubic in mu,
 *
 *     h_mu[n] = C0[n] + mu*(C1[n] + mu*(C2[n] + mu*C3[n]))          n = 0 .. N-1
 *
 * so B119_RS_N * 4 integers describe every one of the 539 phases.  Two evaluation orders
 * are provided and THEY PRODUCE IDENTICAL BYTES, because both round the tap weight to the
 * same int32 h_q[n] at the same point and then run the same accumulation:
 *
 *   DIRECT  (b119_rs_out_direct)  evaluate the cubic per output.  N*4 multiplies,
 *                                 B119_RS_N*4*4 = 640 bytes of table.
 *   BANK    (b119_rs_out_bank)    evaluate all 539 phases ONCE at init into
 *                                 b119_rs_bank[539][N].  N multiplies per output,
 *                                 539*N*4 = 86,240 bytes, built from the same 640.
 *
 * The bank is NOT a 33.7 KB constant in the image: it is derived at boot from 640 bytes.
 * Having both is the control -- one arithmetic, two schedules, and a disagreement between
 * them is a defect report rather than a silent difference.
 *
 * ------------------------------------------------------------------------------------
 * THE QUANTISER IS THE HOST'S, TO THE TIE RULE
 *
 * model_dec_run.py packs the e2e graph's audio field as
 *
 *     q = np.clip(np.rint(w / sc["x"]), -127, 127).astype(np.int8)
 *
 * with w the float32 window on LibriSpeech's +-1.0 convention and sc["x"] the merged
 * graph's own input scale, 0.003431909275806016 (out/b116_lnsplit/ir_lnsplit/graph.json;
 * b114_e2e/ir_cse/graph.json carries the same value).  np.rint is round-half-to-EVEN, and
 * b119_rs_round_shift below implements that rule exactly rather than round-half-up: the
 * encoder's calibration was derived against this grid and a different tie rule is a
 * different grid.
 *
 * The microphone's own convention is fixed by its RTL: MICROPHONE.md s3.4 says the FIR
 * coefficients carry "the scale factor that makes the whole chain's DC gain exactly 32768,
 * so PDM density +-1 maps to +-full scale".  So mic float = pcm / 32768.0, and
 *
 *     int8 = rint_even( pcm * B119_MIC_GAIN / (32768 * 0.003431909275806016) )
 *          = rint_even( pcm * B119_MIC_GAIN / 112.45266... )
 *
 * with B119_MIC_GAIN the ONE calibration constant this path has.  It is carried as a
 * normalised (mantissa, shift) pair so that the whole chain is integer and the constant
 * itself is never the thing that moves an int8 byte.
 */
#ifndef B119_RESAMP_H_
#define B119_RESAMP_H_

#include <stdint.h>
#include "b119_rs_coeffs.h"     /* generated: B119_RS_N, B119_RS_Q, b119_rs_c[4][N], ... */

#define B119_RS_UP     539      /* f_out/f_mic = 539/625, exactly */
#define B119_RS_DOWN   625
#define B119_RS_HIST   64       /* power of two >= B119_RS_N, so the ring masks */
#define B119_RS_HQ     16       /* fractional bits of ONE TAP after the Farrow cubic */

/* WHY THE TAP IS ROUNDED TO Q16 AND THE COEFFICIENTS ARE NOT.  The cubic is evaluated in
 * Q(B119_RS_Q) = Q24 so its three Horner steps keep their precision, and the RESULT is
 * rounded once to Q16.  That is what bounds the accumulator:
 *
 *   |acc| <= 32767 * max_m sum_n |h_q[m][n]|  =  32767 * 137,363  =  2^32.07
 *
 * and it is what lets the gain be carried at nearly full int32 precision -- gain_m is
 * normalised into [2^28, 2^29), so acc * gain_m <= 2^61.1 and the ONE rounding in the
 * whole chain is the one that produces the int8.  Rounding the tap to Q16 costs 7.6e-6
 * per tap, which over 40 taps is 91 dB below the signal: two orders below the int8 input
 * grid's own 37.58 dB.  Carrying the tap at Q24 instead would put |acc| at 2^40.1 and
 * force either a second rounding or a gain quantised to 3.4e-6 -- and a gain quantised
 * that coarsely moves int8 bytes, which is the thing this layout exists to prevent.
 */

#if B119_RS_N > B119_RS_HIST
#error "B119_RS_HIST must be >= B119_RS_N"
#endif

struct b119_rs {
	int16_t  hist[B119_RS_HIST];  /* the last HIST input samples, newest at (wr-1)&mask */
	uint32_t wr;                  /* total input samples pushed, ever */
	uint32_t idx;                 /* input index the NEXT output reads (n_k) */
	uint32_t m;                   /* m_k = (k*625) mod 539, the phase numerator */
	int32_t  gain_m;              /* mantissa, normalised into [2^28, 2^29) */
	int32_t  gain_s;              /* G / (32768 * SCALE_X) == gain_m / 2^gain_s */
	int      use_bank;            /* 0 = evaluate the cubic per output, 1 = read the bank.
	                               * A RUNTIME choice, so one binary can run both orders
	                               * on the same input and prove they are byte-identical. */
	uint32_t nout;                /* outputs produced */
	uint32_t nclip;               /* outputs that hit +-127 */
	uint32_t nsat_lo, nsat_hi;    /* outputs at exactly -127 / +127 */
	int64_t  peak_abs;            /* max |resampled sample|, in int16 mic counts */
	int64_t  sum_sq;              /* sum of squares of the resampled samples */
};

/* ---- round-half-to-even, the rule np.rint uses -------------------------------------- */
static inline int64_t b119_rs_round_shift(int64_t v, int sh)
{
	int64_t half = (int64_t)1 << (sh - 1);
	int64_t frac = v & (((int64_t)1 << sh) - 1);      /* arithmetic: frac >= 0 */
	int64_t r = (v + half) >> sh;                     /* round half UP (toward +inf) */

	if (frac == half) {                               /* an exact tie */
		r -= (r & 1);                             /* ... goes to the EVEN neighbour */
	}
	return r;
}

/* mu in Q16 for phase numerator m: round(m * 65536 / 539), no runtime divide when the
 * caller keeps m incrementally.  539 fits in 10 bits so m*65536 fits in 26. */
static inline uint32_t b119_rs_mu_q16(uint32_t m)
{
	return (uint32_t)(((uint64_t)m * 65536u + 269u) / 539u);
}

/* The tap weight for one phase: the cubic in mu, rounded ONCE to int32 in Q(B119_RS_Q).
 * Both evaluation paths go through this function, which is why they cannot disagree. */
static inline int32_t b119_rs_tap(int n, uint32_t mu_q16)
{
	int64_t t = b119_rs_c[3][n];

	t = ((t * (int64_t)mu_q16) + 32768) >> 16;  t += b119_rs_c[2][n];
	t = ((t * (int64_t)mu_q16) + 32768) >> 16;  t += b119_rs_c[1][n];
	t = ((t * (int64_t)mu_q16) + 32768) >> 16;  t += b119_rs_c[0][n];
	/* Q24 -> Q16, round half to even, ONCE, here -- so the DIRECT and BANK paths cannot
	 * disagree about where the rounding happened. */
	return (int32_t)b119_rs_round_shift(t, B119_RS_Q - B119_RS_HQ);
}

/* The 539-phase bank.  NOT a constant in the image: 539*N*4 = %d bytes derived at boot
 * from the B119_RS_N*4 coefficients above.  Defined by the translation unit that wants it. */
extern int32_t b119_rs_bank[B119_RS_UP][B119_RS_N];

static inline void b119_rs_build_bank(void)
{
	for (uint32_t m = 0; m < B119_RS_UP; m++) {
		uint32_t mu = b119_rs_mu_q16(m);

		for (int n = 0; n < B119_RS_N; n++) {
			b119_rs_bank[m][n] = b119_rs_tap(n, mu);
		}
	}
}

static inline void b119_rs_init(struct b119_rs *s, int32_t gain_m, int32_t gain_s)
{
	for (int i = 0; i < B119_RS_HIST; i++) { s->hist[i] = 0; }
	s->wr = 0; s->idx = 0; s->m = 0; s->gain_m = gain_m; s->gain_s = gain_s;
	s->use_bank = 0;
	s->nout = 0; s->nclip = 0; s->nsat_lo = 0; s->nsat_hi = 0;
	s->peak_abs = 0; s->sum_sq = 0;
}

/* Zero the running statistics without touching the filter state.  THE LEVEL CALIBRATION
 * READS THESE, so they must cover the samples that are KEPT and not the pre-roll that is
 * thrown away -- Lab B119's first board arm set the gain 9.3 dB wrong from a pre-roll that
 * was measuring the DC blocker's startup transient. */
static inline void b119_rs_stats_reset(struct b119_rs *s)
{
	s->nout = 0; s->nclip = 0; s->nsat_lo = 0; s->nsat_hi = 0;
	s->peak_abs = 0; s->sum_sq = 0;
}

/* G / (32768 * SCALE_X) == gain_m / 2^gain_s, SCALE_X = 0.003431909275806016, with
 * gain_m normalised into [2^28, 2^29).  b119_resamp.py --design computes the pair and the
 * generated header carries the default; the board arm can override it with one measured
 * number without recompiling the coefficients. */
static inline void b119_rs_set_gain(struct b119_rs *s, int32_t gain_m, int32_t gain_s)
{
	s->gain_m = gain_m; s->gain_s = gain_s;
}

/* Accumulate one output.  base is the index of the FIRST tap: n_k - D, D = N/2 - 1. */
static inline int64_t b119_rs_acc(const struct b119_rs *s, uint32_t base, uint32_t mu_q16)
{
	int64_t acc = 0;
	uint32_t p = base & (B119_RS_HIST - 1);

	if (s->use_bank) {
		const int32_t *h = b119_rs_bank[s->m];

		for (int n = 0; n < B119_RS_N; n++) {
			acc += (int64_t)s->hist[p] * (int64_t)h[n];
			p = (p + 1) & (B119_RS_HIST - 1);
		}
	} else {
		for (int n = 0; n < B119_RS_N; n++) {
			acc += (int64_t)s->hist[p] * (int64_t)b119_rs_tap(n, mu_q16);
			p = (p + 1) & (B119_RS_HIST - 1);
		}
	}
	return acc;
}

/* Push one microphone sample.  Writes 0, 1 or 2 int8 outputs through `emit` and returns
 * how many.  (625/539 < 2, so at most one output per input in steady state; the loop is
 * written for `while` because the first outputs after a reset can bunch.) */
static inline int b119_rs_push(struct b119_rs *s, int16_t x, int8_t *out, int max_out)
{
	int n_emitted = 0;

	s->hist[s->wr & (B119_RS_HIST - 1)] = x;
	s->wr++;

	/* An output is ready once the newest sample is the LAST tap it needs:
	 * taps are idx-D .. idx-D+N-1, so we need wr-1 >= idx - D + N - 1. */
	while (s->idx + (B119_RS_N - 1 - B119_RS_D) < s->wr && n_emitted < max_out) {
		uint32_t mu = b119_rs_mu_q16(s->m);
		uint32_t base = s->idx - B119_RS_D;
		int64_t acc = b119_rs_acc(s, base, mu);
		int64_t v, q;

		/* statistics on the RESAMPLED signal, in int16 mic counts, before the gain.
		 * These are what the level calibration is read out of on the board. */
		v = b119_rs_round_shift(acc, B119_RS_HQ);
		if (v > s->peak_abs) { s->peak_abs = v; }
		if (-v > s->peak_abs) { s->peak_abs = -v; }
		s->sum_sq += v * v;

		/* ...then the encoder's own grid.  acc is Q16 in int16 mic counts and the gain
		 * is gain_m / 2^gain_s, so the product is Q(16+gain_s) in int8 counts.  ONE
		 * rounding, round-half-to-even, exactly as np.rint. */
		q = b119_rs_round_shift(acc * (int64_t)s->gain_m, B119_RS_HQ + s->gain_s);
		if (q >  127) { q =  127; s->nclip++; s->nsat_hi++; }
		else if (q < -127) { q = -127; s->nclip++; s->nsat_lo++; }
		out[n_emitted++] = (int8_t)q;
		s->nout++;

		/* advance: m += 625 (mod 539), idx += the carry.  625 = 539 + 86. */
		s->m += B119_RS_DOWN;
		while (s->m >= B119_RS_UP) { s->m -= B119_RS_UP; s->idx++; }
	}
	return n_emitted;
}

/* THE LEVEL CALIBRATION, AS INTEGER ARITHMETIC.
 *
 * The encoder's int8 grid was calibrated on LibriSpeech windows whose int8 rms is 21.773
 * counts (b119_resamp.py --quantcheck computes it over the pinned 73-utterance corpus:
 * 7,696,558 samples, float rms 0.075021 on a 0.003431909 grid).  So the calibration
 * target is stated IN int8 COUNTS and SCALE_X never appears at run time:
 *
 *     gain_m / 2^gain_s  =  target_int8_rms / measured_resampled_rms_in_mic_counts
 *
 * The normalisation puts gain_m in [2^28, 2^29) so the constant's own quantisation is
 * 2^-29 relative -- four orders below one int8 count, so the calibration can never be the
 * thing that moves a byte.
 */
static inline void b119_rs_gain_from_rms(uint32_t rms_counts, uint32_t target_milli,
					 int32_t *gm, int32_t *gs)
{
	uint64_t num = (uint64_t)target_milli;
	uint64_t den = (uint64_t)(rms_counts ? rms_counts : 1) * 1000u;
	int sh = 0;

	while (num < (den << 28) && sh < 33) { num <<= 1; sh++; }
	*gm = (int32_t)(num / den);
	*gs = sh;
}

/* How many input samples are needed for `nout` outputs, including the filter's warm-up. */
static inline uint32_t b119_rs_inputs_for(uint32_t nout)
{
	/* output nout-1 needs input index floor((nout-1)*625/539) - D + N - 1 */
	uint64_t last = ((uint64_t)(nout - 1) * B119_RS_DOWN) / B119_RS_UP;
	return (uint32_t)(last + B119_RS_N - B119_RS_D);
}

#endif /* B119_RESAMP_H_ */
```

## src/b119_rs_coeffs.h
```c
/* @generated by fpga/pynq-z2/modelblaster/moonshine/b119_resamp.py --design
 * DO NOT EDIT.  Lab B119.
 *
 *   f_mic  = 18552.875696 Hz   (FCLK0 40000000 / 2156, Lab B110 measured 18552.875)
 *   ratio  = 539/625 exactly
 *   taps   = 40, cubic in mu, passband 7000 Hz, stopband 8000 Hz, weight 4
 *   scales = coefficients Q24, taps Q16, gain a normalised (m, s) pair
 *   bounds : max|Cq| 18071496,  max|h_q| 52651 (Q16),  max sum|h_q| 137765,
 *            |acc| <= 32767 * max sum|h_q| = 4514145755 = 2^32.1; x gain_m < 2^29 -> 2^61.1
 */
#ifndef B119_RS_COEFFS_H_
#define B119_RS_COEFFS_H_
#include <stdint.h>

#define B119_RS_N      40
#define B119_RS_D      19
#define B119_RS_Q      24
#define B119_RS_FMIC_MILLIHZ   18552876
#define B119_RS_SCALE_X_E9     3431909   /* the encoder's input scale x 1e9 */
/* G / (32768 * %.18g) == m / 2^s, for G = %g -- Lab B119's level calibration.
 * Override at run time with b119_rs_set_gain(); the coefficients do not change. */
#define B119_RS_GAIN_M_DEFAULT 305537214
#define B119_RS_GAIN_S_DEFAULT 35
#define B119_RS_GAIN_G_DEFAULT_E6 1000000   /* G x 1e6 */

static const int32_t b119_rs_c[4][B119_RS_N] = {
  { -17906, 54720, -73357, 54199, 10135, -104845, 192067, -221491, 151677, 26192, -271638, 495685, -581924, 424319, 31415, -757709, 1640588, -2504161, 3136565, 13472437, 3069941, -2445402, 1633068, -785140, 64215, 404054, -579398, 506518, -286910, 37536, 148633, -226213, 200511, -112067, 12737, 56848, -79435, 61365, -22864, -14405 },
  { -160544, 121499, 10240, -201605, 368621, -402528, 224435, 162213, -639263, 994114, -987925, 463743, 552315, -1788536, 2739928, -2734778, 986724, 3656801, -14940986, 663653, 14457064, -4335497, -213808, 2430248, -2838525, 2102639, -881316, -263141, 970443, -1126861, 837214, -331236, -146230, 428700, -467088, 319465, -98348, -86451, 173281, -158677 },
  { 172639, -302230, 297193, -96319, -277040, 689993, -932079, 795457, -187294, -782108, 1774809, -2303858, 1898160, -317984, -2255186, 5092789, -6819325, 4889881, 8789192, -18071496, 2963799, 10464456, -8321994, 3404839, 472284, -2579135, 2982762, -2186271, 871737, 336509, -1046053, 1156012, -811288, 279981, 178161, -409855, 395731, -221087, 7943, 146035 },
  { -8550, 103108, -172706, 164340, -44967, -169767, 403435, -535696, 448828, -89830, -477436, 1057378, -1362158, 1103252, -112784, -1535454, 3406758, -4410442, 571713, 7004399, -7019590, -545072, 4397749, -3409658, 1545054, 103163, -1097332, 1360918, -1059788, 481482, 86136, -446749, 535517, -404644, 171472, 43579, -163708, 172830, -103684, 9188 },
};

#endif /* B119_RS_COEFFS_H_ */
```
